; Lauterbach TRACE32 debugger script to boot CPU with bootloader in NOR.

winclear

; Setup JTAG for CPU.
do &(TARGET_SOC)/&(TARGET_SOC)_cpu_jtag_setup.cmm

; This should be set to "auto" if the symbol information
; is built with the correct labeling of "arm" vs. "thumb"
; mode code areas.
;system.option.dismode.auto
system.option.dismode.access

; Setup for kernel virtual addressing mode.
do virtual_setup.cmm

System.down
;Break.Delete
sYmbol.RESet

system.up

; For some reason the first system.up does not always work.
; Do another one to be sure.
wait 100.ms
system.up

;setup.stepbystep on

; Disable the MMU and caches.
do cpu_disable_mmu.cmm

print "Loading &FASTBOOT symbols"
data.load.elf &FASTBOOT /NOCODE
register.set PC &NOR_LOAD_ADDR

IF "&TRANSLATE_SRC_PATH"=="TRUE"
(
  SYMBOL.SOURCEPATH.TRANSLATE "&BUILDTOP" "&TOP"
)

; Setup common toolbar items
do toolbar_setup.cmm

; Restore saved window configuration (this is always saved in the home directory -- don't change the path)
;do ~/windows.cmm

; mode.hll

enddo

