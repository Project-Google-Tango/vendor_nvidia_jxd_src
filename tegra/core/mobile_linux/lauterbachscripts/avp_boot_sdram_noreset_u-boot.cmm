; Lauterbach TRACE32 debugger script to boot AVP with U-BOOT loaded into SDRAM by this script without resetting the chip.

; NOTE: THIS SCRIPT WILL WORK ONLY ON UN-FUSED PARTS.

LOCAL &UBOOT_SRC_DIR

&UBOOT_SRC_DIR=os.env(UBOOT_SRC_DIR)
IF "&UBOOT_SRC_DIR"==""
(
  PRINT "Please set UBOOT_SRC_DIR to u-boot source directory"
  STOP
)

winclear

; Setup JTAG for AVP
do &(TARGET_SOC)/&(TARGET_SOC)_avp_jtag_setup.cmm

; This should be set to "auto" if the symbol information
; is built with the correct labeling of "arm" vs. "thumb"
; mode code areas.
;system.option.dismode.auto
system.option.dismode.access

; Tell the debugger not to access non-existent memory locations.
do physical_setup.cmm

;Break.Delete
;sYmbol.RESet

system.mode.attach
break

&UBOOT="&UBOOT_SRC_DIR/spl/u-boot-spl"
print "Loading &UBOOT symbols"
data.load.elf &UBOOT /NOCODE /GNU

IF "&TRANSLATE_SRC_PATH"=="TRUE"
(
  SYMBOL.SOURCEPATH.TRANSLATE "&BUILDTOP" "&TOP"
)

; Setup common toolbar items
do toolbar_setup.cmm

IF ("&LOAD_SAVED_AVP_WINDOWS"=="TRUE")
(
  ; Restore saved window configuration (this is always saved in the $T32SYS directory -- don't change the path)
  do &T32SYS/windows.cmm
)

;mode.hll

enddo

