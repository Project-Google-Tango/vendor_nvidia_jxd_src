; Copyright (c) 2012, NVIDIA CORPORATION.  All rights reserved.
; For NVIDIA internal use only. Customers should not use this script
; unless NVIDIA explicitly directs them to do so.

; Lauterbach TRACE32 debugger script to power the up the CPU from the AVP.

; NOTE: THIS SCRIPT WILL WORK ONLY ON UN-FUSED PARTS.

; Setup JTAG for AVP-only.
do &(TARGET_SOC)/&(TARGET_SOC)_avp_jtag_setup.cmm

; Tell the debugger not to access non-existent memory locations.
do physical_setup.cmm

system.mode.up
do avp_read_revision.cmm

do &(TARGET_SOC)/&(TARGET_CONFIG)_init_cpu.cmm

ENDDO

