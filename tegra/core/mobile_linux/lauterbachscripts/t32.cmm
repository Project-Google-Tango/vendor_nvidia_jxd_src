;---------------------------------------------------------------
; Copyright (c) 2012, NVIDIA CORPORATION.  All rights reserved.
;---------------------------------------------------------------
; Default startup program for TRACE32
; This script must reside in the $T32SYS directory

GLOBAL &T32_INSTANCE
GLOBAL &T32SYS
&T32_INSTANCE=os.env(T32_INSTANCE)
&T32SYS=os.env(T32SYS)

; Choose hex mode for input
radix hex

; Perform common user customization.
do &T32SYS/user_config.cmm

; Set up common paths and global environment.
do setup_environment.cmm

IF "&T32_INSTANCE"==""
(
  PRINT "Environment variable T32_INSTANCE not set -- assuming cpu"
  WAIT 3.s
  &T32_INSTANCE="cpu"
)

; Determine which instance of TRACE32 is being started
IF "&T32_INSTANCE"=="cpu"
(
  ; Perform CPU-side custom initialization
  do cpu_menu_setup.cmm
)
ELSE IF "&T32_INSTANCE"=="avp"
(
  ; Perform AVP-side custom initialization
  do avp_menu_setup.cmm
)
ELSE IF "&T32_INSTANCE"=="coredump"
(
  ; Perform Coredump custom initialization
  do coredump_menu_setup.cmm
)
ELSE IF "&T32_INSTANCE"=="ramdump"
(
  ; Perform RAMdump custom initialization
  do ramdump_menu_setup.cmm
)
ELSE
(
  PRINT "Environment variable T32_INSTANCE is invalid -- must be cpu or avp or coredump or ramdump"
  STOP
)

if language()!=""
(
  local &menuname
  &menuname="~~/t32"+language()
  menu.rp &menuname
)

; Recall and Define History File
autostore , history bookmark

PRINT "TEGRA_TOP=&TEGRA_TOP, TARGET_OS=&TARGET_OS, TARGET_SOC=&TARGET_SOC, TARGET_BOARD=&TARGET_BOARD, TARGET_CONFIG=&TARGET_CONFIG, BUILD_FLAVOR=&BUILD_FLAVOR"

enddo

