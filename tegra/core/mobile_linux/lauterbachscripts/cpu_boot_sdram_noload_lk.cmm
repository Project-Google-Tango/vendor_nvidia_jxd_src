; Copyright (c) 2013, NVIDIA CORPORATION.  All rights reserved.
; For NVIDIA internal use only. Customers should not use this script
; unless NVIDIA explicitly directs them to do so.

; Lauterbach TRACE32 debugger script to boot CPU with LittleKernel(LK) already present in SDRAM.

LOCAL &LK_SRC_DIR

&LK_SRC_DIR=os.env(LK_SRC_DIR)
IF "&LK_SRC_DIR"==""
(
  PRINT "Please set LK_SRC_DIR to LittleKernel(LK) source directory"
  STOP
)

winclear

; Setup JTAG for CPU.
do &(TARGET_SOC)/&(TARGET_SOC)_cpu_jtag_setup.cmm

; This should be set to "auto" if the symbol information
; is built with the correct labeling of "arm" vs. "thumb"
; mode code areas.
;system.option.dismode.auto
system.option.dismode.access

; Tell the debugger not to access non-existent memory locations.
do physical_setup.cmm

sYmbol.RESet

;ON ERROR JUMPTO nobreak

system.mode.attach
break

nobreak:
ON ERROR
&LK="&LK_SRC_DIR/../out/build-&(TARGET_BOARD)/lk"
print "Loading &LK symbols"

data.load.elf &LK /NOCODE /GNU

IF "&TRANSLATE_SRC_PATH"=="TRUE"
(
  SYMBOL.SOURCEPATH.TRANSLATE "&BUILDTOP" "&TOP"
)


; Setup common toolbar items
do toolbar_setup.cmm

; Set up the DCC debug console using the SWI interface.
IF "&ENABLE_DCC_WINDOW"=="TRUE"
(
  do cpu_dcc_swi_setup.cmm
)

IF ("&LOAD_SAVED_WINDOWS"=="TRUE")
(
  ; Restore saved window configuration (this is always saved in the $T32SYS directory -- don't change the path)
  do &T32SYS/windows.cmm
)

;mode.hll

enddo

