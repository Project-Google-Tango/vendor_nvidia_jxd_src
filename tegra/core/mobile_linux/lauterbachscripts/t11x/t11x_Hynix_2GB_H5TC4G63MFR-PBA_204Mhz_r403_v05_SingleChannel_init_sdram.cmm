; Copyright (c) 2013, NVIDIA CORPORATION.  All rights reserved.
; For NVIDIA internal use only. Customers should not use this script
; unless NVIDIA explicitly directs them to do so.
; Based on Hynix_2GB_H5TC4G63MFR-PBA_204Mhz_r403_v05_SingleChannel.cfg

print "t11x_Hynix_2GB_H5TC4G63MFR-PBA_204Mhz_r403_v05_SingleChannel_init_sdram.cmm"


D.S SD:0x4003FF00 %LE %LONG  0xEAFFFFFF ;
D.S SD:0x4003FF04 %LE %LONG  0xEAFFFFFF ;
D.S SD:0x4003FF08 %LE %LONG  0xEAFFFFFF ;
D.S SD:0x4003FF0C %LE %LONG  0xEAFFFFFF ;
D.S SD:0x4003FF10 %LE %LONG  0xEAFFFFFF ;
D.S SD:0x4003FF14 %LE %LONG  0xEAFFFFFF ;
D.S SD:0x4003FF18 %LE %LONG  0xEAFFFFFF ;
D.S SD:0x4003FF1C %LE %LONG  0xEAFFFFFF ;
D.S SD:0x4003FF20 %LE %LONG  0xE51FF004 ;
D.S SD:0x4003FF24 %LE %LONG  0x4003FF00 ;
D.S SD:0x6000F100 %LE %LONG  0x4003FF00 ; EVP_CPU_RESET_VECTOR_0
;; RefClk=12000000 PLLX=700000000 PLLM=408000000 PLLC=600000000 PLLP=216000000
D.S SD:0x60006050 %LE %LONG  0x800003F1 ; CLK_RST_CONTROLLER_OSC_CTRL_0
D.S SD:0x60006050 %LE %LONG  0x800003F1 ; CLK_RST_CONTROLLER_OSC_CTRL_0
D.S SD:0x60005014 %LE %LONG  0x0000000B ; TIMERUS_USEC_CFG_0
D.S SD:0x60006328 %LE %LONG  0x00000CC0 ; CLK_RST_CONTROLLER_CLK_ENB_H_SET_0
D.S SD:0x7000E420 %LE %LONG  0x00000000 ; APBDEV_PMC_DPD_SAMPLE_0
D.S SD:0x7000E424 %LE %LONG  0x00000000 ; APBDEV_PMC_DPD_ENABLE_0
D.S SD:0x600060DC %LE %LONG  0x00800820 ; CLK_RST_CONTROLLER_PLLD_MISC_0
D.S SD:0x600060DC %LE %LONG  0x00000820 ; CLK_RST_CONTROLLER_PLLD_MISC_0
D.S SD:0x600064BC %LE %LONG  0x00800820 ; CLK_RST_CONTROLLER_PLLD2_MISC_0
D.S SD:0x600064BC %LE %LONG  0x00000820 ; CLK_RST_CONTROLLER_PLLD2_MISC_0
D.S SD:0x60006084 %LE %LONG  0x00000002 ; CLK_RST_CONTROLLER_PLLC_OUT_0
D.S SD:0x60006094 %LE %LONG  0x00000002 ; CLK_RST_CONTROLLER_PLLM_OUT_0
D.S SD:0x600060A4 %LE %LONG  0x00020002 ; CLK_RST_CONTROLLER_PLLP_OUTA_0
D.S SD:0x600060A8 %LE %LONG  0x00020002 ; CLK_RST_CONTROLLER_PLLP_OUTB_0
D.S SD:0x600060B4 %LE %LONG  0x00000002 ; CLK_RST_CONTROLLER_PLLA_OUT_0
D.S SD:0x60006014 %LE %LONG  0x02000800 ; CLK_RST_CONTROLLER_CLK_OUT_ENB_H_0
D.S SD:0x60006098 %LE %LONG  0x0F000000 ; CLK_RST_CONTROLLER_PLLM_MISC1_0
D.S SD:0x60006014 %LE %LONG  0x02000800 ; CLK_RST_CONTROLLER_CLK_OUT_ENB_H_0
D.S SD:0x600060AC %LE %LONG  0x00040100 ; CLK_RST_CONTROLLER_PLLP_MISC_0
D.S SD:0x600060A0 %LE %LONG  0x8000010C ; CLK_RST_CONTROLLER_PLLP_BASE_0
D.S SD:0x600060A0 %LE %LONG  0xC000010C ; CLK_RST_CONTROLLER_PLLP_BASE_0
D.S SD:0x60006080 %LE %LONG  0x00003201 ; CLK_RST_CONTROLLER_PLLC_BASE_0
D.S SD:0x60006080 %LE %LONG  0x40003201 ; CLK_RST_CONTROLLER_PLLC_BASE_0
D.S SD:0x60006090 %LE %LONG  0x80002201 ; CLK_RST_CONTROLLER_PLLM_BASE_0
D.S SD:0x60006090 %LE %LONG  0xC0002201 ; CLK_RST_CONTROLLER_PLLM_BASE_0
D.S SD:0x60006090 %LE %LONG  0x40002201 ; CLK_RST_CONTROLLER_PLLM_BASE_0
D.S SD:0x600060CC %LE %LONG  0x00400C20 ; CLK_RST_CONTROLLER_PLLU_MISC_0
D.S SD:0x600060C0 %LE %LONG  0x0003C00C ; CLK_RST_CONTROLLER_PLLU_BASE_0
D.S SD:0x600060C0 %LE %LONG  0x4003C00C ; CLK_RST_CONTROLLER_PLLU_BASE_0
D.S SD:0x600060C0 %LE %LONG  0x43E3C00C ; CLK_RST_CONTROLLER_PLLU_BASE_0
D.S SD:0x600060D0 %LE %LONG  0x80006302 ; CLK_RST_CONTROLLER_PLLD_BASE_0
D.S SD:0x600060D0 %LE %LONG  0xC0006302 ; CLK_RST_CONTROLLER_PLLD_BASE_0
D.S SD:0x600060D0 %LE %LONG  0x40006302 ; CLK_RST_CONTROLLER_PLLD_BASE_0
D.S SD:0x600064B8 %LE %LONG  0x80006302 ; CLK_RST_CONTROLLER_PLLD2_BASE_0
D.S SD:0x600064B8 %LE %LONG  0xC0006302 ; CLK_RST_CONTROLLER_PLLD2_BASE_0
D.S SD:0x600064B8 %LE %LONG  0x40006302 ; CLK_RST_CONTROLLER_PLLD2_BASE_0
D.S SD:0x600060E0 %LE %LONG  0x80107501 ; CLK_RST_CONTROLLER_PLLX_BASE_0
D.S SD:0x600060E0 %LE %LONG  0xC0107501 ; CLK_RST_CONTROLLER_PLLX_BASE_0
D.S SD:0x600060E0 %LE %LONG  0x40107501 ; CLK_RST_CONTROLLER_PLLX_BASE_0
D.S SD:0x600060A0 %LE %LONG  0x4000010C ; CLK_RST_CONTROLLER_PLLP_BASE_0
D.S SD:0x60006098 %LE %LONG  0x00000000 ; CLK_RST_CONTROLLER_PLLM_MISC1_0
D.S SD:0x600060DC %LE %LONG  0x40000820 ; CLK_RST_CONTROLLER_PLLD_MISC_0
D.S SD:0x600064BC %LE %LONG  0x40000820 ; CLK_RST_CONTROLLER_PLLD2_MISC_0
D.S SD:0x60006084 %LE %LONG  0x00000003 ; CLK_RST_CONTROLLER_PLLC_OUT_0
D.S SD:0x60006094 %LE %LONG  0x00000003 ; CLK_RST_CONTROLLER_PLLM_OUT_0
D.S SD:0x600060A4 %LE %LONG  0x00030003 ; CLK_RST_CONTROLLER_PLLP_OUTA_0
D.S SD:0x600060A8 %LE %LONG  0x00030003 ; CLK_RST_CONTROLLER_PLLP_OUTB_0
D.S SD:0x600060A4 %LE %LONG  0x00030003 ; CLK_RST_CONTROLLER_PLLP_OUTA_0
D.S SD:0x600060A4 %LE %LONG  0x00030003 ; CLK_RST_CONTROLLER_PLLP_OUTA_0
D.S SD:0x600060A8 %LE %LONG  0x00030003 ; CLK_RST_CONTROLLER_PLLP_OUTB_0
D.S SD:0x600060A8 %LE %LONG  0x00030003 ; CLK_RST_CONTROLLER_PLLP_OUTB_0
D.S SD:0x600060A4 %LE %LONG  0x00030D03 ; CLK_RST_CONTROLLER_PLLP_OUTA_0
D.S SD:0x600060A4 %LE %LONG  0x00030D03 ; CLK_RST_CONTROLLER_PLLP_OUTA_0
D.S SD:0x600060A4 %LE %LONG  0x07030D03 ; CLK_RST_CONTROLLER_PLLP_OUTA_0
D.S SD:0x600060A4 %LE %LONG  0x07030D03 ; CLK_RST_CONTROLLER_PLLP_OUTA_0
D.S SD:0x600060A8 %LE %LONG  0x00030403 ; CLK_RST_CONTROLLER_PLLP_OUTB_0
D.S SD:0x600060A8 %LE %LONG  0x00030403 ; CLK_RST_CONTROLLER_PLLP_OUTB_0
D.S SD:0x600060A8 %LE %LONG  0x02030403 ; CLK_RST_CONTROLLER_PLLP_OUTB_0
D.S SD:0x600060A8 %LE %LONG  0x02030403 ; CLK_RST_CONTROLLER_PLLP_OUTB_0
D.S SD:0x600060B0 %LE %LONG  0x80318819 ; CLK_RST_CONTROLLER_PLLA_BASE_0
D.S SD:0x600060B0 %LE %LONG  0xC0318819 ; CLK_RST_CONTROLLER_PLLA_BASE_0
D.S SD:0x600060BC %LE %LONG  0x00040100 ; CLK_RST_CONTROLLER_PLLA_MISC_0
D.S SD:0x600060B0 %LE %LONG  0x48318819 ; CLK_RST_CONTROLLER_PLLA_BASE_0
WAIT 50.ms
D.S SD:0x600060B4 %LE %LONG  0x00000003 ; CLK_RST_CONTROLLER_PLLA_OUT_0
D.S SD:0x60006084 %LE %LONG  0x00000603 ; CLK_RST_CONTROLLER_PLLC_OUT_0
D.S SD:0x60006094 %LE %LONG  0x00000203 ; CLK_RST_CONTROLLER_PLLM_OUT_0
D.S SD:0x600064EC %LE %LONG  0x28647050 ; CLK_RST_CONTROLLER_PLLC2_MISC_0_0
D.S SD:0x600064F0 %LE %LONG  0x000D2308 ; CLK_RST_CONTROLLER_PLLC2_MISC_1_0
D.S SD:0x600064F4 %LE %LONG  0x10111200 ; CLK_RST_CONTROLLER_PLLC2_MISC_2_0
D.S SD:0x600064E8 %LE %LONG  0x00000101 ; CLK_RST_CONTROLLER_PLLC2_BASE_0
D.S SD:0x600064EC %LE %LONG  0x68647050 ; CLK_RST_CONTROLLER_PLLC2_MISC_0_0
D.S SD:0x600064E8 %LE %LONG  0x00106401 ; CLK_RST_CONTROLLER_PLLC2_BASE_0
D.S SD:0x600064E8 %LE %LONG  0x40106401 ; CLK_RST_CONTROLLER_PLLC2_BASE_0
D.S SD:0x600064EC %LE %LONG  0x28654040 ; CLK_RST_CONTROLLER_PLLC2_MISC_0_0
D.S SD:0x600064F0 %LE %LONG  0x000D2308 ; CLK_RST_CONTROLLER_PLLC2_MISC_1_0
D.S SD:0x600064EC %LE %LONG  0xA8654040 ; CLK_RST_CONTROLLER_PLLC2_MISC_0_0
D.S SD:0x600064EC %LE %LONG  0x28654040 ; CLK_RST_CONTROLLER_PLLC2_MISC_0_0
WAIT 50.ms
D.S SD:0x60006500 %LE %LONG  0x28647050 ; CLK_RST_CONTROLLER_PLLC3_MISC_0_0
D.S SD:0x60006504 %LE %LONG  0x000D2308 ; CLK_RST_CONTROLLER_PLLC3_MISC_1_0
D.S SD:0x60006508 %LE %LONG  0x10111200 ; CLK_RST_CONTROLLER_PLLC3_MISC_2_0
D.S SD:0x600064FC %LE %LONG  0x00000101 ; CLK_RST_CONTROLLER_PLLC3_BASE_0
D.S SD:0x60006500 %LE %LONG  0x68647050 ; CLK_RST_CONTROLLER_PLLC3_MISC_0_0
D.S SD:0x600064FC %LE %LONG  0x00106401 ; CLK_RST_CONTROLLER_PLLC3_BASE_0
D.S SD:0x600064FC %LE %LONG  0x40106401 ; CLK_RST_CONTROLLER_PLLC3_BASE_0
D.S SD:0x60006500 %LE %LONG  0x28654040 ; CLK_RST_CONTROLLER_PLLC3_MISC_0_0
D.S SD:0x60006504 %LE %LONG  0x000D2308 ; CLK_RST_CONTROLLER_PLLC3_MISC_1_0
D.S SD:0x60006500 %LE %LONG  0xA8654040 ; CLK_RST_CONTROLLER_PLLC3_MISC_0_0
D.S SD:0x60006500 %LE %LONG  0x28654040 ; CLK_RST_CONTROLLER_PLLC3_MISC_0_0
WAIT 50.ms
D.S SD:0x60006320 %LE %LONG  0xFDFFFFF0 ; CLK_RST_CONTROLLER_CLK_ENB_L_SET_0
D.S SD:0x60006328 %LE %LONG  0xFFDDFFF7 ; CLK_RST_CONTROLLER_CLK_ENB_H_SET_0
D.S SD:0x60006330 %LE %LONG  0xFBFFFBFE ; CLK_RST_CONTROLLER_CLK_ENB_U_SET_0
D.S SD:0x60006440 %LE %LONG  0xFFFCFFFC ; CLK_RST_CONTROLLER_CLK_ENB_V_SET_0
D.S SD:0x60006448 %LE %LONG  0xDF7FBFFD ; CLK_RST_CONTROLLER_CLK_ENB_W_SET_0
D.S SD:0x60006304 %LE %LONG  0xFDFFFFE2 ; CLK_RST_CONTROLLER_RST_DEV_L_CLR_0
D.S SD:0x6000630C %LE %LONG  0xFFDDF7A7 ; CLK_RST_CONTROLLER_RST_DEV_H_CLR_0
D.S SD:0x60006314 %LE %LONG  0x8A8FFEFE ; CLK_RST_CONTROLLER_RST_DEV_U_CLR_0
D.S SD:0x60006434 %LE %LONG  0xFF81FFE4 ; CLK_RST_CONTROLLER_RST_DEV_V_CLR_0
D.S SD:0x6000643C %LE %LONG  0xDF607FFF ; CLK_RST_CONTROLLER_RST_DEV_W_CLR_0
D.S SD:0x6000643C %LE %LONG  0x5F607FFF ; CLK_RST_CONTROLLER_RST_DEV_W_CLR_0
D.S SD:0x60006020 %LE %LONG  0x20001111 ; CLK_RST_CONTROLLER_CCLK_BURST_POLICY_0
D.S SD:0x60006024 %LE %LONG  0x80000000 ; CLK_RST_CONTROLLER_SUPER_CCLK_DIVIDER_0
D.S SD:0x60006028 %LE %LONG  0x20003333 ; CLK_RST_CONTROLLER_SCLK_BURST_POLICY_0
D.S SD:0x6000602C %LE %LONG  0x80000000 ; CLK_RST_CONTROLLER_SUPER_SCLK_DIVIDER_0
D.S SD:0x60006030 %LE %LONG  0x00000000 ; CLK_RST_CONTROLLER_CLK_SYSTEM_RATE_0
D.S SD:0x6000619C %LE %LONG  0x80000000 ; CLK_RST_CONTROLLER_CLK_SOURCE_EMC_0
D.S SD:0x60006090 %LE %LONG  0x40002201 ; CLK_RST_CONTROLLER_PLLM_BASE_0
D.S SD:0x60006138 %LE %LONG  0x40000000 ; CLK_RST_CONTROLLER_CLK_SOURCE_DISP1_0
D.S SD:0x6000613C %LE %LONG  0x40000000 ; CLK_RST_CONTROLLER_CLK_SOURCE_DISP2_0
D.S SD:0x600061D0 %LE %LONG  0x00000004 ; CLK_RST_CONTROLLER_CLK_SOURCE_NOR_0
D.S SD:0x600061D8 %LE %LONG  0x90000002 ; CLK_RST_CONTROLLER_CLK_SOURCE_I2S0_0
D.S SD:0x60006100 %LE %LONG  0x90000002 ; CLK_RST_CONTROLLER_CLK_SOURCE_I2S1_0
D.S SD:0x60006104 %LE %LONG  0x90000002 ; CLK_RST_CONTROLLER_CLK_SOURCE_I2S2_0
D.S SD:0x60006134 %LE %LONG  0x00000002 ; CLK_RST_CONTROLLER_CLK_SOURCE_SBC1_0
D.S SD:0x60006118 %LE %LONG  0x00000002 ; CLK_RST_CONTROLLER_CLK_SOURCE_SBC2_0
D.S SD:0x6000611C %LE %LONG  0x00000002 ; CLK_RST_CONTROLLER_CLK_SOURCE_SBC3_0
D.S SD:0x600061B4 %LE %LONG  0x00000002 ; CLK_RST_CONTROLLER_CLK_SOURCE_SBC4_0
D.S SD:0x60006124 %LE %LONG  0x00000002 ; CLK_RST_CONTROLLER_CLK_SOURCE_I2C1_0
D.S SD:0x60006198 %LE %LONG  0x00000002 ; CLK_RST_CONTROLLER_CLK_SOURCE_I2C2_0
D.S SD:0x600061B8 %LE %LONG  0x00000002 ; CLK_RST_CONTROLLER_CLK_SOURCE_I2C3_0
D.S SD:0x60006128 %LE %LONG  0x00000006 ; CLK_RST_CONTROLLER_CLK_SOURCE_I2C5_0
D.S SD:0x60006158 %LE %LONG  0x40000003 ; CLK_RST_CONTROLLER_CLK_SOURCE_G3D_0
D.S SD:0x600063B0 %LE %LONG  0x40000003 ; CLK_RST_CONTROLLER_CLK_SOURCE_G3D2_0
D.S SD:0x6000615C %LE %LONG  0x00000002 ; CLK_RST_CONTROLLER_CLK_SOURCE_G2D_0
D.S SD:0x60006160 %LE %LONG  0x00000002 ; CLK_RST_CONTROLLER_CLK_SOURCE_NDFLASH_0
D.S SD:0x60006168 %LE %LONG  0x00000002 ; CLK_RST_CONTROLLER_CLK_SOURCE_VFIR_0
D.S SD:0x6000616C %LE %LONG  0x00000002 ; CLK_RST_CONTROLLER_CLK_SOURCE_EPP_0
D.S SD:0x60006180 %LE %LONG  0x00000002 ; CLK_RST_CONTROLLER_CLK_SOURCE_HOST1X_0
D.S SD:0x6000618C %LE %LONG  0x40000006 ; CLK_RST_CONTROLLER_CLK_SOURCE_HDMI_0
D.S SD:0x600063E4 %LE %LONG  0x00000007 ; CLK_RST_CONTROLLER_CLK_SOURCE_HDA2CODEC_2X_0
D.S SD:0x60006170 %LE %LONG  0x00000002 ; CLK_RST_CONTROLLER_CLK_SOURCE_MPE_0
D.S SD:0x60006148 %LE %LONG  0x00000002 ; CLK_RST_CONTROLLER_CLK_SOURCE_VI_0
D.S SD:0x600061C8 %LE %LONG  0x00000001 ; CLK_RST_CONTROLLER_CLK_SOURCE_VDE_0
;; REFCLK = 12000 khz
;; File=Hynix_2GB_H5TC4G63MFR-PBA_204Mhz_r403_v05_SingleChannel.cfg Freq=408 tclk=2.450980
D.S SD:0x7000E4F8 %LE %LONG  0x00001000 ; APBDEV_PMC_PLLP_WB0_OVERRIDE_0
D.S SD:0x7000E6B0 %LE %LONG  0x00000000 ; APBDEV_PMC_PLLM_WB0_OVERRIDE2_0
D.S SD:0x7000E5DC %LE %LONG  0x00002201 ; APBDEV_PMC_PLLM_WB0_OVERRIDE_FREQ_0
D.S SD:0x7000E6B0 %LE %LONG  0x00000000 ; APBDEV_PMC_PLLM_WB0_OVERRIDE2_0
D.S SD:0x60006094 %LE %LONG  0x00000202 ; CLK_RST_CONTROLLER_PLLM_OUT_0
D.S SD:0x60006098 %LE %LONG  0x00000000 ; CLK_RST_CONTROLLER_PLLM_MISC1_0
D.S SD:0x6000609C %LE %LONG  0x00000000 ; CLK_RST_CONTROLLER_PLLM_MISC2_0
D.S SD:0x60006090 %LE %LONG  0x00002201 ; CLK_RST_CONTROLLER_PLLM_BASE_0
D.S SD:0x60006090 %LE %LONG  0x40002201 ; CLK_RST_CONTROLLER_PLLM_BASE_0
D.S SD:0x60006094 %LE %LONG  0x00000203 ; CLK_RST_CONTROLLER_PLLM_OUT_0
D.S SD:0x7000E5CC %LE %LONG  0x00000002 ; APBDEV_PMC_VDDP_SEL_0
D.S SD:0x7000E4E8 %LE %LONG  0x00000003 ; APBDEV_PMC_DDR_PWR_0
D.S SD:0x7000E5D0 %LE %LONG  0x00000092 ; APBDEV_PMC_DDR_CFG_0
D.S SD:0x7000E5D4 %LE %LONG  0x00000000 ; APBDEV_PMC_E_NO_VTTGEN_0
D.S SD:0x7000E444 %LE %LONG  0x00000000 ; APBDEV_PMC_NO_IOPOWER_0
D.S SD:0x7000E5B8 %LE %LONG  0x80800000 ; APBDEV_PMC_IO_DPD_REQ_0
D.S SD:0x7000E5C0 %LE %LONG  0x00000000 ; APBDEV_PMC_IO_DPD2_REQ_0
D.S SD:0x7000E6CC %LE %LONG  0x00000000 ; APBDEV_PMC_REG_SHORT_0
D.S SD:0x60006014 %LE %LONG  0xFFDDFFF7 ; CLK_RST_CONTROLLER_CLK_OUT_ENB_H_0
WAIT 50.ms
D.S SD:0x60006014 %LE %LONG  0xFFDDFFF7 ; CLK_RST_CONTROLLER_CLK_OUT_ENB_H_0
WAIT 50.ms
D.S SD:0x60006364 %LE %LONG  0xDF7FBFFD ; CLK_RST_CONTROLLER_CLK_OUT_ENB_W_0
WAIT 50.ms
D.S SD:0x60006364 %LE %LONG  0xDF7FBFFD ; CLK_RST_CONTROLLER_CLK_OUT_ENB_W_0
WAIT 50.ms
D.S SD:0x60006008 %LE %LONG  0x00000000 ; CLK_RST_CONTROLLER_RST_DEVICES_H_0
WAIT 50.ms
D.S SD:0x60006008 %LE %LONG  0x00000000 ; CLK_RST_CONTROLLER_RST_DEVICES_H_0
WAIT 50.ms
D.S SD:0x6000635C %LE %LONG  0x00000000 ; CLK_RST_CONTROLLER_RST_DEVICES_W_0
WAIT 50.ms
D.S SD:0x6000635C %LE %LONG  0x00000000 ; CLK_RST_CONTROLLER_RST_DEVICES_W_0
WAIT 50.ms
D.S SD:0x6000619C %LE %LONG  0x40000002 ; CLK_RST_CONTROLLER_CLK_SOURCE_EMC_0
WAIT 50.ms
D.S SD:0x7001A488 %LE %LONG  0x0396071A ; EMC_ADDR_SWIZZLE_STACK1A_1
D.S SD:0x7001A48C %LE %LONG  0x000425B8 ; EMC_ADDR_SWIZZLE_STACK1B_1
D.S SD:0x7001A490 %LE %LONG  0x07412306 ; EMC_ADDR_SWIZZLE_STACK2A_1
D.S SD:0x7001A494 %LE %LONG  0x00000598 ; EMC_ADDR_SWIZZLE_STACK2B_1
D.S SD:0x7001A498 %LE %LONG  0x00534012 ; EMC_ADDR_SWIZZLE_STACK3_1
D.S SD:0x7001A400 %LE %LONG  0x00000036 ; EMC_SWIZZLE_RANK0_BYTE_CFG_1
D.S SD:0x7001A404 %LE %LONG  0x30571246 ; EMC_SWIZZLE_RANK0_BYTE0_1
D.S SD:0x7001A408 %LE %LONG  0x26043715 ; EMC_SWIZZLE_RANK0_BYTE1_1
D.S SD:0x7001A40C %LE %LONG  0x42675013 ; EMC_SWIZZLE_RANK0_BYTE2_1
D.S SD:0x7001A410 %LE %LONG  0x05736241 ; EMC_SWIZZLE_RANK0_BYTE3_1
D.S SD:0x7001A414 %LE %LONG  0x00000036 ; EMC_SWIZZLE_RANK1_BYTE_CFG_1
D.S SD:0x7001A418 %LE %LONG  0x30571246 ; EMC_SWIZZLE_RANK1_BYTE0_1
D.S SD:0x7001A41C %LE %LONG  0x26043715 ; EMC_SWIZZLE_RANK1_BYTE1_1
D.S SD:0x7001A420 %LE %LONG  0x42675013 ; EMC_SWIZZLE_RANK1_BYTE2_1
D.S SD:0x7001A424 %LE %LONG  0x05736241 ; EMC_SWIZZLE_RANK1_BYTE3_1
D.S SD:0x7001B2F0 %LE %LONG  0x001112A0 ; EMC_XM2CMDPADCTRL_0
D.S SD:0x7001B2F4 %LE %LONG  0x770C0000 ; EMC_XM2CMDPADCTRL2_0
D.S SD:0x7001B464 %LE %LONG  0x050C0000 ; EMC_XM2CMDPADCTRL3_0
D.S SD:0x7001B484 %LE %LONG  0x00000000 ; EMC_XM2CMDPADCTRL4_0
D.S SD:0x7001B2F8 %LE %LONG  0x770C1414 ; EMC_XM2DQSPADCTRL_0
D.S SD:0x7001B2FC %LE %LONG  0x0000A11C ; EMC_XM2DQSPADCTRL2_0
D.S SD:0x7001B0F8 %LE %LONG  0x20820800 ; EMC_XM2DQSPADCTRL3_0
D.S SD:0x7001B320 %LE %LONG  0x0079E79E ; EMC_XM2DQSPADCTRL4_0
D.S SD:0x7001B300 %LE %LONG  0x770C2990 ; EMC_XM2DQPADCTRL_0
D.S SD:0x7001B304 %LE %LONG  0x00000000 ; EMC_XM2DQPADCTRL2_0
D.S SD:0x7001B308 %LE %LONG  0x77FFC085 ; EMC_XM2CLKPADCTRL_0
D.S SD:0x7001B3FC %LE %LONG  0x00000808 ; EMC_XM2CLKPADCTRL2_0
D.S SD:0x7001B30C %LE %LONG  0x81F1F108 ; EMC_XM2COMPPADCTRL_0
D.S SD:0x7001B310 %LE %LONG  0x05057404 ; EMC_XM2VTTGENPADCTRL_0
D.S SD:0x7001B314 %LE %LONG  0x0000003F ; EMC_XM2VTTGENPADCTRL2_0
D.S SD:0x7001B028 %LE %LONG  0x00000001 ; EMC_TIMING_CONTROL_0
D.S SD:0x70019648 %LE %LONG  0xFFF00000 ; MC_VIDEO_PROTECT_BOM_0
D.S SD:0x7001964C %LE %LONG  0x00000000 ; MC_VIDEO_PROTECT_SIZE_MB_0
D.S SD:0x70019418 %LE %LONG  0x009A4752 ; MC_VIDEO_PROTECT_VPR_OVERRIDE_0
D.S SD:0x70019054 %LE %LONG  0x00000000 ; MC_EMEM_ADR_CFG_0
D.S SD:0x70019058 %LE %LONG  0x00080303 ; MC_EMEM_ADR_CFG_DEV0_0
D.S SD:0x7001905C %LE %LONG  0x00080303 ; MC_EMEM_ADR_CFG_DEV1_0
D.S SD:0x70019060 %LE %LONG  0x00000000 ; MC_EMEM_ADR_CFG_CHANNEL_MASK_0
D.S SD:0x70019644 %LE %LONG  0x00000008 ; MC_EMEM_ADR_CFG_CHANNEL_MASK_PROPAGATION_COUNT_0
D.S SD:0x70019064 %LE %LONG  0x00000400 ; MC_EMEM_ADR_CFG_BANK_MASK_0_0
D.S SD:0x70019068 %LE %LONG  0x00000800 ; MC_EMEM_ADR_CFG_BANK_MASK_1_0
D.S SD:0x7001906C %LE %LONG  0x00001000 ; MC_EMEM_ADR_CFG_BANK_MASK_2_0
D.S SD:0x70019050 %LE %LONG  0x00000800 ; MC_EMEM_CFG_0
D.S SD:0x70019670 %LE %LONG  0xFFF00000 ; MC_SEC_CARVEOUT_BOM_0
D.S SD:0x70019674 %LE %LONG  0x00000000 ; MC_SEC_CARVEOUT_SIZE_MB_0
D.S SD:0x70019090 %LE %LONG  0x01000003 ; MC_EMEM_ARB_CFG_0
D.S SD:0x70019094 %LE %LONG  0x800000FE ; MC_EMEM_ARB_OUTSTANDING_REQ_0
D.S SD:0x70019098 %LE %LONG  0x00000001 ; MC_EMEM_ARB_TIMING_RCD_0
D.S SD:0x7001909C %LE %LONG  0x00000001 ; MC_EMEM_ARB_TIMING_RP_0
D.S SD:0x700190A0 %LE %LONG  0x00000005 ; MC_EMEM_ARB_TIMING_RC_0
D.S SD:0x700190A4 %LE %LONG  0x00000002 ; MC_EMEM_ARB_TIMING_RAS_0
D.S SD:0x700190A8 %LE %LONG  0x00000004 ; MC_EMEM_ARB_TIMING_FAW_0
D.S SD:0x700190AC %LE %LONG  0x00000001 ; MC_EMEM_ARB_TIMING_RRD_0
D.S SD:0x700190B0 %LE %LONG  0x00000002 ; MC_EMEM_ARB_TIMING_RAP2PRE_0
D.S SD:0x700190B4 %LE %LONG  0x00000008 ; MC_EMEM_ARB_TIMING_WAP2PRE_0
D.S SD:0x700190B8 %LE %LONG  0x00000002 ; MC_EMEM_ARB_TIMING_R2R_0
D.S SD:0x700190BC %LE %LONG  0x00000001 ; MC_EMEM_ARB_TIMING_W2W_0
D.S SD:0x700190C0 %LE %LONG  0x00000003 ; MC_EMEM_ARB_TIMING_R2W_0
D.S SD:0x700190C4 %LE %LONG  0x00000006 ; MC_EMEM_ARB_TIMING_W2R_0
D.S SD:0x700190D0 %LE %LONG  0x06030102 ; MC_EMEM_ARB_DA_TURNS_0
D.S SD:0x700190D4 %LE %LONG  0x000A0405 ; MC_EMEM_ARB_DA_COVERS_0
D.S SD:0x700190D8 %LE %LONG  0x73840A06 ; MC_EMEM_ARB_MISC0_0
D.S SD:0x700190DC %LE %LONG  0x78000000 ; MC_EMEM_ARB_MISC1_0
D.S SD:0x700190E0 %LE %LONG  0x001F0000 ; MC_EMEM_ARB_RING1_THROTTLE_0
D.S SD:0x700190E8 %LE %LONG  0x00000083 ; MC_EMEM_ARB_OVERRIDE_0
D.S SD:0x700190EC %LE %LONG  0xFF00FF00 ; MC_EMEM_ARB_RSV_0
D.S SD:0x700190FC %LE %LONG  0x00000001 ; MC_TIMING_CONTROL_0
D.S SD:0x700190F4 %LE %LONG  0x00000000 ; MC_CLKEN_OVERRIDE_0
D.S SD:0x7001B010 %LE %LONG  0x00000000 ; EMC_ADR_CFG_0
D.S SD:0x7001B140 %LE %LONG  0x00000000 ; EMC_CLKEN_OVERRIDE_0
D.S SD:0x7001B2DC %LE %LONG  0x00000802 ; EMC_CTT_TERM_CTRL_0
D.S SD:0x7001B2A8 %LE %LONG  0x001FFFFF ; EMC_AUTO_CAL_INTERVAL_0
D.S SD:0x7001A458 %LE %LONG  0x00000000 ; EMC_AUTO_CAL_CONFIG2_1
D.S SD:0x7001A45C %LE %LONG  0x00000000 ; EMC_AUTO_CAL_CONFIG3_1
D.S SD:0x7001A2A4 %LE %LONG  0xA0F10000 ; EMC_AUTO_CAL_CONFIG_1
WAIT 50.ms
D.S SD:0x7001B2B8 %LE %LONG  0x000008C1 ; EMC_CFG_2_0
D.S SD:0x7001B008 %LE %LONG  0x01000400 ; EMC_DBG_0
D.S SD:0x7001B0F0 %LE %LONG  0x10004408 ; EMC_CMDQ_0
D.S SD:0x7001B0F4 %LE %LONG  0x06000404 ; EMC_MC2EMCQ_0
D.S SD:0x7001B0C8 %LE %LONG  0x000C000C ; EMC_MRS_WAIT_CNT_0
D.S SD:0x7001B0C4 %LE %LONG  0x000C000C ; EMC_MRS_WAIT_CNT2_0
D.S SD:0x7001B104 %LE %LONG  0x0000AA88 ; EMC_FBIO_CFG5_0
D.S SD:0x7001B02C %LE %LONG  0x00000009 ; EMC_RC_0
D.S SD:0x7001B030 %LE %LONG  0x00000035 ; EMC_RFC_0
D.S SD:0x7001B0C0 %LE %LONG  0x00000000 ; EMC_RFC_SLR_0
D.S SD:0x7001B034 %LE %LONG  0x00000007 ; EMC_RAS_0
D.S SD:0x7001B038 %LE %LONG  0x00000002 ; EMC_RP_0
D.S SD:0x7001B144 %LE %LONG  0x00000000 ; EMC_R2R_0
D.S SD:0x7001B148 %LE %LONG  0x00000000 ; EMC_W2W_0
D.S SD:0x7001B03C %LE %LONG  0x00000004 ; EMC_R2W_0
D.S SD:0x7001B040 %LE %LONG  0x0000000A ; EMC_W2R_0
D.S SD:0x7001B044 %LE %LONG  0x00000003 ; EMC_R2P_0
D.S SD:0x7001B048 %LE %LONG  0x0000000B ; EMC_W2P_0
D.S SD:0x7001B04C %LE %LONG  0x00000002 ; EMC_RD_RCD_0
D.S SD:0x7001B050 %LE %LONG  0x00000002 ; EMC_WR_RCD_0
D.S SD:0x7001B054 %LE %LONG  0x00000003 ; EMC_RRD_0
D.S SD:0x7001B058 %LE %LONG  0x00000001 ; EMC_REXT_0
D.S SD:0x7001B0B8 %LE %LONG  0x00000000 ; EMC_WEXT_0
D.S SD:0x7001B05C %LE %LONG  0x00000005 ; EMC_WDV_0
D.S SD:0x7001B2D0 %LE %LONG  0x00000005 ; EMC_WDV_MASK_0
D.S SD:0x7001B060 %LE %LONG  0x00000007 ; EMC_QUSE_0
D.S SD:0x7001B468 %LE %LONG  0x00000006 ; EMC_IBDLY_0
D.S SD:0x7001B14C %LE %LONG  0x00000004 ; EMC_EINPUT_0
D.S SD:0x7001B150 %LE %LONG  0x00000004 ; EMC_EINPUT_DURATION_0
D.S SD:0x7001B154 %LE %LONG  0x00010000 ; EMC_PUTERM_EXTRA_0
D.S SD:0x7001B3F4 %LE %LONG  0x00000000 ; EMC_CDB_CNTL_1_0
D.S SD:0x7001B3F8 %LE %LONG  0x00000000 ; EMC_CDB_CNTL_2_0
D.S SD:0x7001B064 %LE %LONG  0x00000004 ; EMC_QRST_0
D.S SD:0x7001B068 %LE %LONG  0x00000009 ; EMC_QSAFE_0
D.S SD:0x7001B06C %LE %LONG  0x0000000D ; EMC_RDV_0
D.S SD:0x7001B2CC %LE %LONG  0x0000000D ; EMC_RDV_MASK_0
D.S SD:0x7001B0BC %LE %LONG  0x00000000 ; EMC_CTT_0
D.S SD:0x7001B2D8 %LE %LONG  0x00000000 ; EMC_CTT_DURATION_0
D.S SD:0x7001B070 %LE %LONG  0x00000607 ; EMC_REFRESH_0
D.S SD:0x7001B074 %LE %LONG  0x00000000 ; EMC_BURST_REFRESH_NUM_0
D.S SD:0x7001B3DC %LE %LONG  0x00000181 ; EMC_PRE_REFRESH_REQ_CNT_0
D.S SD:0x7001B078 %LE %LONG  0x00000002 ; EMC_PDEX2WR_0
D.S SD:0x7001B07C %LE %LONG  0x00000002 ; EMC_PDEX2RD_0
D.S SD:0x7001B080 %LE %LONG  0x00000001 ; EMC_PCHG2PDEN_0
D.S SD:0x7001B084 %LE %LONG  0x00000000 ; EMC_ACT2PDEN_0
D.S SD:0x7001B088 %LE %LONG  0x00000032 ; EMC_AR2PDEN_0
D.S SD:0x7001B08C %LE %LONG  0x0000000F ; EMC_RW2PDEN_0
D.S SD:0x7001B090 %LE %LONG  0x00000038 ; EMC_TXSR_0
D.S SD:0x7001B3E4 %LE %LONG  0x00000038 ; EMC_TXSRDLL_0
D.S SD:0x7001B094 %LE %LONG  0x00000004 ; EMC_TCKE_0
D.S SD:0x7001B158 %LE %LONG  0x00000004 ; EMC_TCKESR_0
D.S SD:0x7001B15C %LE %LONG  0x00000004 ; EMC_TPD_0
D.S SD:0x7001B098 %LE %LONG  0x00000009 ; EMC_TFAW_0
D.S SD:0x7001B09C %LE %LONG  0x00000000 ; EMC_TRPAB_0
D.S SD:0x7001B0A0 %LE %LONG  0x00000004 ; EMC_TCLKSTABLE_0
D.S SD:0x7001B0A4 %LE %LONG  0x00000005 ; EMC_TCLKSTOP_0
D.S SD:0x7001B0A8 %LE %LONG  0x00000638 ; EMC_TREFBW_0
D.S SD:0x7001B0B0 %LE %LONG  0x00000020 ; EMC_ODT_WRITE_0
D.S SD:0x7001B0B4 %LE %LONG  0x00000000 ; EMC_ODT_READ_0
D.S SD:0x7001B0AC %LE %LONG  0x00000006 ; EMC_QUSE_EXTRA_0
D.S SD:0x7001B114 %LE %LONG  0x00000004 ; EMC_FBIO_CFG6_0
D.S SD:0x7001B2BC %LE %LONG  0x000000A0 ; EMC_CFG_DIG_DLL_0
D.S SD:0x7001B2C0 %LE %LONG  0x00008000 ; EMC_CFG_DIG_DLL_PERIOD_0
D.S SD:0x7001B100 %LE %LONG  0x02000000 ; EMC_FBIO_SPARE_0
D.S SD:0x7001B120 %LE %LONG  0xFF00FF00 ; EMC_CFG_RSV_0
D.S SD:0x7001B328 %LE %LONG  0x0006C000 ; EMC_DLL_XFORM_DQS0_0
D.S SD:0x7001B32C %LE %LONG  0x0006C000 ; EMC_DLL_XFORM_DQS1_0
D.S SD:0x7001B330 %LE %LONG  0x0006C000 ; EMC_DLL_XFORM_DQS2_0
D.S SD:0x7001B334 %LE %LONG  0x0006C000 ; EMC_DLL_XFORM_DQS3_0
D.S SD:0x7001B338 %LE %LONG  0x0006C000 ; EMC_DLL_XFORM_DQS4_0
D.S SD:0x7001B33C %LE %LONG  0x0006C000 ; EMC_DLL_XFORM_DQS5_0
D.S SD:0x7001B340 %LE %LONG  0x0006C000 ; EMC_DLL_XFORM_DQS6_0
D.S SD:0x7001B344 %LE %LONG  0x0006C000 ; EMC_DLL_XFORM_DQS7_0
D.S SD:0x7001B348 %LE %LONG  0x00000000 ; EMC_DLL_XFORM_QUSE0_0
D.S SD:0x7001B34C %LE %LONG  0x00000000 ; EMC_DLL_XFORM_QUSE1_0
D.S SD:0x7001B350 %LE %LONG  0x00000000 ; EMC_DLL_XFORM_QUSE2_0
D.S SD:0x7001B354 %LE %LONG  0x00000000 ; EMC_DLL_XFORM_QUSE3_0
D.S SD:0x7001B358 %LE %LONG  0x00000000 ; EMC_DLL_XFORM_QUSE4_0
D.S SD:0x7001B35C %LE %LONG  0x00000000 ; EMC_DLL_XFORM_QUSE5_0
D.S SD:0x7001B360 %LE %LONG  0x00000000 ; EMC_DLL_XFORM_QUSE6_0
D.S SD:0x7001B364 %LE %LONG  0x00000000 ; EMC_DLL_XFORM_QUSE7_0
D.S SD:0x7001B368 %LE %LONG  0x00048000 ; EMC_DLL_XFORM_DQ0_0
D.S SD:0x7001B36C %LE %LONG  0x00048000 ; EMC_DLL_XFORM_DQ1_0
D.S SD:0x7001B370 %LE %LONG  0x00048000 ; EMC_DLL_XFORM_DQ2_0
D.S SD:0x7001B374 %LE %LONG  0x00048000 ; EMC_DLL_XFORM_DQ3_0
D.S SD:0x7001B46C %LE %LONG  0x00000000 ; EMC_DLL_XFORM_ADDR0_0
D.S SD:0x7001B470 %LE %LONG  0x00000000 ; EMC_DLL_XFORM_ADDR1_0
D.S SD:0x7001B474 %LE %LONG  0x00000000 ; EMC_DLL_XFORM_ADDR2_0
D.S SD:0x7001B3A8 %LE %LONG  0x00000000 ; EMC_DLI_TRIM_TXDQS0_0
D.S SD:0x7001B3AC %LE %LONG  0x00000000 ; EMC_DLI_TRIM_TXDQS1_0
D.S SD:0x7001B3B0 %LE %LONG  0x00000000 ; EMC_DLI_TRIM_TXDQS2_0
D.S SD:0x7001B3B4 %LE %LONG  0x00000000 ; EMC_DLI_TRIM_TXDQS3_0
D.S SD:0x7001B3B8 %LE %LONG  0x00000000 ; EMC_DLI_TRIM_TXDQS4_0
D.S SD:0x7001B3BC %LE %LONG  0x00000000 ; EMC_DLI_TRIM_TXDQS5_0
D.S SD:0x7001B3C0 %LE %LONG  0x00000000 ; EMC_DLI_TRIM_TXDQS6_0
D.S SD:0x7001B3C4 %LE %LONG  0x00000000 ; EMC_DLI_TRIM_TXDQS7_0
D.S SD:0x7001B124 %LE %LONG  0x00000000 ; EMC_ACPD_CONTROL_0
D.S SD:0x7001B47C %LE %LONG  0x0000003F ; EMC_DSR_VTTGEN_DRV_0
D.S SD:0x7001B480 %LE %LONG  0x00000000 ; EMC_TXDSRVTTGEN_0
D.S SD:0x7001B434 %LE %LONG  0x1F7DF7DF ; EMC_CA_TRAINING_TIMING_CNTL1_0
D.S SD:0x7001B438 %LE %LONG  0x0000001F ; EMC_CA_TRAINING_TIMING_CNTL2_0
D.S SD:0x7001B00C %LE %LONG  0x03C0000E ; EMC_CFG_0
D.S SD:0x7001B028 %LE %LONG  0x00000001 ; EMC_TIMING_CONTROL_0
WAIT 50.ms
D.S SD:0x7000E664 %LE %LONG  0x00000000 ; APBDEV_PMC_SCRATCH1_ECO_0
WAIT 50.ms
D.S SD:0x7001B024 %LE %LONG  0x00000000 ; EMC_PIN_0
WAIT 50.ms
D.S SD:0x7001B024 %LE %LONG  0x00000100 ; EMC_PIN_0
WAIT 50.ms
D.S SD:0x7001B024 %LE %LONG  0x00000101 ; EMC_PIN_0
WAIT 50.ms
D.S SD:0x7001B0DC %LE %LONG  0x80000001 ; EMC_NOP_0
D.S SD:0x7001B12C %LE %LONG  0x80200008 ; EMC_EMRS2_0
D.S SD:0x7001B130 %LE %LONG  0x80300000 ; EMC_EMRS3_0
D.S SD:0x7001B0D0 %LE %LONG  0x80100003 ; EMC_EMRS_0
D.S SD:0x7001B0CC %LE %LONG  0x80001221 ; EMC_MRS_0
D.S SD:0x7001B2EC %LE %LONG  0x80000011 ; EMC_ZQ_CAL_0
WAIT 50.ms
D.S SD:0x7001B2E0 %LE %LONG  0x00020000 ; EMC_ZCAL_INTERVAL_0
D.S SD:0x7001B2E4 %LE %LONG  0x00000042 ; EMC_ZCAL_WAIT_CNT_0
D.S SD:0x7001B2E8 %LE %LONG  0x80000000 ; EMC_ZCAL_MRW_CMD_0
D.S SD:0x7001B028 %LE %LONG  0x00000001 ; EMC_TIMING_CONTROL_0
D.S SD:0x7001B0D4 %LE %LONG  0x80000303 ; EMC_REF_0
D.S SD:0x7001B020 %LE %LONG  0x80000002 ; EMC_REFCTRL_0
D.S SD:0x7001B3E0 %LE %LONG  0x80000D22 ; EMC_DYN_SELF_REF_CONTROL_0
D.S SD:0x7001B00C %LE %LONG  0x7320000E ; EMC_CFG_0
D.S SD:0x7001B3D8 %LE %LONG  0x0004032C ; EMC_SEL_DPD_CTRL_0
D.S SD:0x7001B100 %LE %LONG  0x02000000 ; EMC_FBIO_SPARE_0
D.S SD:0x7001B028 %LE %LONG  0x00000001 ; EMC_TIMING_CONTROL_0
D.S SD:0x6000C0E0 %LE %LONG  0x00010000 ; AHB_ARBITRATION_XBAR_CTRL_0
D.S SD:0x70019650 %LE %LONG  0x00000000 ; MC_VIDEO_PROTECT_REG_CTRL_0
D.S SD:0x70019664 %LE %LONG  0x00000001 ; MC_EMEM_CFG_ACCESS_CTRL_0
D.S SD:0x70019678 %LE %LONG  0x00000000 ; MC_SEC_CARVEOUT_REG_CTRL_0
D.S SD:0x60004028 %LE %LONG  0xFFFFFFFF ; PRI_ICTLR_CPU_IER_CLR_0
D.S SD:0x60004128 %LE %LONG  0xFFFFFFFF ; SEC_ICTLR_CPU_IER_CLR_0
D.S SD:0x60004228 %LE %LONG  0xFFFFFFFF ; TRI_ICTLR_CPU_IER_CLR_0
D.S SD:0x6000402C %LE %LONG  0x00000000 ; PRI_ICTLR_CPU_IEP_CLASS_0
D.S SD:0x6000412C %LE %LONG  0x00000000 ; SEC_ICTLR_CPU_IEP_CLASS_0
D.S SD:0x6000422C %LE %LONG  0x00000000 ; TRI_ICTLR_CPU_IEP_CLASS_0
D.S SD:0x60004038 %LE %LONG  0xFFFFFFFF ; PRI_ICTLR_COP_IER_CLR_0
D.S SD:0x60004138 %LE %LONG  0xFFFFFFFF ; SEC_ICTLR_COP_IER_CLR_0
D.S SD:0x60004238 %LE %LONG  0xFFFFFFFF ; TRI_ICTLR_COP_IER_CLR_0
D.S SD:0x6000403C %LE %LONG  0x00000000 ; PRI_ICTLR_COP_IEP_CLASS_0
D.S SD:0x6000413C %LE %LONG  0x00000000 ; SEC_ICTLR_COP_IEP_CLASS_0
D.S SD:0x6000423C %LE %LONG  0x00000000 ; TRI_ICTLR_COP_IEP_CLASS_0
