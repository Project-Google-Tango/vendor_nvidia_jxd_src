LOCAL &IS_RUNNING
&IS_RUNNING=RUN()
if (&IS_RUNNING)
(
    break								; target is still running
)

do toolbar_setup.cmm

D.S SD:0x60006050 %LE %LONG 0x03FFFFFF	; CLK_RST_CONTROLLER_OSC_CTRL_0
D.S SD:0x60005014 %LE %LONG 0x0000000C	; TIMERUS_USEC_CFG_0
D.S SD:0x6000504c %LE %LONG 0x0000001F	; TIMERUS_CNTR_FREEZE_0

;; set up PLLP to 216MHz (NO BYPASS, ENABLE, REF_ENABLE, no OVERRIDE)
D.S SD:0x600060AC %LE %LONG 0x00040100	; CLK_RST_CONTROLLER_PLLP_MISC_0
D.S SD:0x600060A0 %LE %LONG 0x5800D80D	; CLK_RST_CONTROLLER_PLLP_BASE_0
D.S SD:0x600060A4 %LE %LONG 0x02070F07	; CLK_RST_CONTROLLER_PLLP_OUTA_0
D.S SD:0x600060A8 %LE %LONG 0x00070607	; CLK_RST_CONTROLLER_PLLP_OUTB_0

;; set up PLLC to 700MHz default
D.S SD:0x60006080 %LE %LONG 0x4802BC0C	; CLK_RST_CONTROLLER_PLLC_BASE_0

;; set up PLLM
;D.S SD:0x60006090 %LE %LONG 0x40003301	; CLK_RST_CONTROLLER_PLLM_BASE_0
D.S SD:0x60006090 %LE %LONG 0x44002601	; CLK_RST_CONTROLLER_PLLM_BASE_0

;; set up PLLX
D.S SD:0x600060E0 %LE %LONG 0x4803FE0C	; CLK_RST_CONTROLLER_PLLX_BASE_0

;; set up peripheral clock sources
D.S SD:0x60006178 %LE %LONG 0xC000001A ; CLK_RST_CONTROLLER_CLK_SOURCE_UARTA_0

;; set safe graphics divider
D.S SD:0x60006180 %LE %LONG 0x0000000A ; CLK_RST_CONTROLLER_CLK_SOURCE_HOST1X_0
D.S SD:0x6000616C %LE %LONG 0x0000000A ; CLK_RST_CONTROLLER_CLK_SOURCE_EPP_0
D.S SD:0x6000615C %LE %LONG 0x0000000A ; CLK_RST_CONTROLLER_CLK_SOURCE_G2D_0
D.S SD:0x60006158 %LE %LONG 0x0000000A ; CLK_RST_CONTROLLER_CLK_SOURCE_G3D_0
D.S SD:0x600063B0 %LE %LONG 0x0000000A ; CLK_RST_CONTROLLER_CLK_SOURCE_G3D2_0
D.S SD:0x600061F0 %LE %LONG 0x0000000A ; CLK_RST_CONTROLLER_CLK_SOURCE_MSENC_0
D.S SD:0x600061F4 %LE %LONG 0x8000000A ; CLK_RST_CONTROLLER_CLK_SOURCE_TSEC_0
D.S SD:0x60006148 %LE %LONG 0x0000000A ; CLK_RST_CONTROLLER_CLK_SOURCE_VI_0
D.S SD:0x600061A8 %LE %LONG 0x0000000A ; CLK_RST_CONTROLLER_CLK_SOURCE_VI_SENSOR_0

;; enable clocks
D.S SD:0x60006320 %LE %LONG 0xFDFFFFF0 ; CLK_RST_CONTROLLER_CLK_OUT_ENB_L_0
D.S SD:0x60006328 %LE %LONG 0xFFDDFFF7 ; CLK_RST_CONTROLLER_CLK_OUT_ENB_H_0
D.S SD:0x60006330 %LE %LONG 0xFBFFFBFE ; CLK_RST_CONTROLLER_CLK_OUT_ENB_U_0
D.S SD:0x60006440 %LE %LONG 0xDFFF7FFF ; CLK_RST_CONTROLLER_CLK_OUT_ENB_V_0
D.S SD:0x60006448 %LE %LONG 0xFF7F81FE ; CLK_RST_CONTROLLER_CLK_OUT_ENB_W_0

;; clear reset
D.S SD:0x60006304 %LE %LONG 0x00000001 ; CLK_RST_CONTROLLER_RST_DEV_L_CLR_0
D.S SD:0x6000630C %LE %LONG 0xFFDDF7A7 ; CLK_RST_CONTROLLER_RST_DEV_H_CLR_0
D.S SD:0x60006314 %LE %LONG 0x8A8FFEFE ; CLK_RST_CONTROLLER_RST_DEV_U_CLR_0
D.S SD:0x60006434 %LE %LONG 0xFF81FFEC ; CLK_RST_CONTROLLER_RST_DEV_V_CLR_0
D.S SD:0x6000643C %LE %LONG 0xDF607FFF ; CLK_RST_CONTROLLER_RST_DEV_W_CLR_0

D.S SD:0x6000C208 %LE %LONG 0x01C0008F ; SB_PFCFG_0

;; set up UART
D.S SD:0x7000600C %LE %LONG 0x00000080 ; UART_LCR_0
D.S SD:0x70006000 %LE %LONG 0x00000019 ; UART_THR_DLAB_0_0
D.S SD:0x70006004 %LE %LONG 0x00000000 ; UART_IER_DLAB_0_0
D.S SD:0x7000600C %LE %LONG 0x00000003 ; UART_LCR_0
D.S SD:0x70006008 %LE %LONG 0x00000007 ; UART_IIR_FCR_0
D.S SD:0x70006010 %LE %LONG 0x00000003 ; UART_MCR_0

D.S sd:0x70050FB0 %LE %LONG 0xC5ACCE55 ; CSITE_CPUDBG0_LAR_0

;; set up pinmux for UARTA
D.S SD:0x70003000 %LE %LONG 0x00000028 ; PINMUX_AUX_ULPI_DATA0_0
D.S SD:0x70003004 %LE %LONG 0x00000028 ; PINMUX_AUX_ULPI_DATA1_0
D.S SD:0x70003054 %LE %LONG 0x00000020 ; PINMUX_AUX_SDMMC1_DAT2_0
D.S SD:0x70003058 %LE %LONG 0x00000020 ; PINMUX_AUX_SDMMC1_DAT1_0
D.S SD:0x70003184 %LE %LONG 0x00000020 ; PINMUX_AUX_GPIO_PU0_0
D.S SD:0x70003188 %LE %LONG 0x00000020 ; PINMUX_AUX_GPIO_PU1_0
D.S SD:0x7000339C %LE %LONG 0x00000028 ; PINMUX_AUX_SDMMC3_DAT1_0
D.S SD:0x70003394 %LE %LONG 0x00000028 ; PINMUX_AUX_SDMMC3_CMD_0
D.S SD:0x7000316C %LE %LONG 0x00000022 ; PINMUX_AUX_UART2_RTS_N_0
D.S SD:0x70003170 %LE %LONG 0x00000022 ; PINMUX_AUX_UART2_CTS_N_0
D.S SD:0x700032E0 %LE %LONG 0x00000027 ; PINMUX_AUX_KB_ROW9_0
D.S SD:0x700032E4 %LE %LONG 0x00000027 ; PINMUX_AUX_KB_ROW10_0

&CCLK_BURST_POLICY=data.long(D:0x60006020) ;
&CCLK_BURST_POLICY=&CCLK_BURST_POLICY&0xffff0000
&CCLK_BURST_POLICY=&CCLK_BURST_POLICY|0x8888
D.S SD:0x60006020 %LE %LONG &CCLK_BURST_POLICY ; set CCLK source to pllx

;; set up command line
GLOBAL &CMDLINE
GLOBAL &MEMORY_SIZE

LOCAL &CHIPID
LOCAL &MAJOR
LOCAL &MINOR
LOCAL &NETLIST
LOCAL &PATCH
LOCAL &CHIPID_HEX
LOCAL &MAJOR_HEX
LOCAL &MINOR_HEX
LOCAL &NETLIST_HEX
LOCAL &PATCH_HEX
LOCAL &BAUD_RATE

; Get the memory size
&MEMORY_SIZE=data.long(D:0x7000E4A0)    ; APBDEV_PMC_SCRATCH20_0
&MEMORY_SIZE=&MEMORY_SIZE&0xF0000000

; Get the memory size
&MEMORY_SIZE=0x20000000

; Generate the "tegraid" string for the command line
&CHIPID=data.long(A:0x70000804)    ; APB_MISC_GP_HIDREV_0
&MAJOR=&CHIPID
&MINOR=&CHIPID
&CHIPID=(&CHIPID>>8)&0xFF
&MAJOR=(&MAJOR>>4)&0xF
&MINOR=((&MINOR>>8)>>8)&0xF        ; For some reason >>16 does not work

&NETLIST=data.long(A:0x70000860)   ; APB_MISC_GP_EMU_REVID_0
&PATCH=&NETLIST
&NETLIST=(&NETLIST&0xFFFF)
&PATCH=((&PATCH>>8)>>8)&0xFF       ; For some reason >>16 does not work

&CHIPID_HEX=FORMAT.HEX(2.,&CHIPID)
&MAJOR_HEX=FORMAT.HEX(1.,&MAJOR)
&MINOR_HEX=FORMAT.HEX(1.,&MINOR)
&NETLIST_HEX=FORMAT.HEX(2.,&NETLIST)
&PATCH_HEX=FORMAT.HEX(2.,&PATCH)

&BAUD_RATE="1200"

; 512MB SDRAM with 128MB Carveout at top of memory
&CMDLINE="tegraid=&CHIPID_HEX.&MAJOR_HEX.&MINOR_HEX.&NETLIST_HEX.&PATCH_HEX mem=512M@2048M vmalloc=256M video=tegrafb console=ttyS0,&(BAUD_RATE)n8 earlyprintk"

;; set up tags
local &tags
&tags=&TAGS_ADDR
&RAMDISK_SIZE=os.file.size("&RAMDISK")

d.s &tags+0x00 %long 5
d.s &tags+0x04 %long 0x54410001
d.s &tags+0x08 %long 1
d.s &tags+0x0C %long 4096
d.s &tags+0x10 %long 0xFF
&tags=&tags+0x14

d.s &tags+0x00 %long 4
d.s &tags+0x04 %long 0x54420005
d.s &tags+0x08 %long &RAMDISK_ADDR
d.s &tags+0x0C %long &RAMDISK_SIZE
&tags=&tags+0x10

d.s &tags+0x00 %long 0x42
d.s &tags+0x04 %long 0x54410009
&tags=&tags+0x08
d.s &tags++0x100 %byte 0
d.s &tags "&CMDLINE"
&tags=&tags+0x100

; End of tags marker
d.s &tags+0x00 %long 0
d.s &tags+0x04 %long 0

R.S R0 0x0
R.S R1 &MACHINE_ID
R.S R2 &TAGS_ADDR
R.S PC &KERNEL_RUN_PHYS

do cpu_dcc_setup.cmm
