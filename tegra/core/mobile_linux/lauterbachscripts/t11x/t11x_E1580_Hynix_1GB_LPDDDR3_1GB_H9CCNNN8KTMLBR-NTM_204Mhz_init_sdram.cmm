R.S CPSR 0xD3
D.S sd:0x40000000 %LE %LONG -1 -1 -1 -1 -1 -1 -1 -1 -1 -1 -1 -1 -1 -1 -1 -1
D.S sd:0x4000004c %LE %LONG 0
D.S SD:0x60006098 %LE %LONG  0x0F000000 ; CLK_RST_CONTROLLER_PLLM_MISC1_0
D.S SD:0x60006090 %LE %LONG  0x80002201 ; CLK_RST_CONTROLLER_PLLM_BASE_0
D.S SD:0x60006090 %LE %LONG  0xC0002201 ; CLK_RST_CONTROLLER_PLLM_BASE_0
D.S SD:0x60006090 %LE %LONG  0x40002201 ; CLK_RST_CONTROLLER_PLLM_BASE_0
D.S SD:0x60006098 %LE %LONG  0x00000000 ; CLK_RST_CONTROLLER_PLLM_MISC1_0
D.S SD:0x6000619C %LE %LONG  0x80000000 ; CLK_RST_CONTROLLER_CLK_SOURCE_EMC_0
D.S SD:0x7000E4F8 %LE %LONG  0x00001000 ; APBDEV_PMC_PLLP_WB0_OVERRIDE_0
D.S SD:0x7000E6B0 %LE %LONG  0x08000000 ; APBDEV_PMC_PLLM_WB0_OVERRIDE2_0
D.S SD:0x7000E5DC %LE %LONG  0x00002201 ; APBDEV_PMC_PLLM_WB0_OVERRIDE_FREQ_0
D.S SD:0x7000E6B0 %LE %LONG  0x08000000 ; APBDEV_PMC_PLLM_WB0_OVERRIDE2_0
D.S SD:0x6000609C %LE %LONG  0x00000000 ; CLK_RST_CONTROLLER_PLLM_MISC2_0
D.S SD:0x60006090 %LE %LONG  0x00102201 ; CLK_RST_CONTROLLER_PLLM_BASE_0
D.S SD:0x60006090 %LE %LONG  0x40102201 ; CLK_RST_CONTROLLER_PLLM_BASE_0
D.S SD:0x60006094 %LE %LONG  0x00000203 ; CLK_RST_CONTROLLER_PLLM_OUT_0
D.S SD:0x7000E5CC %LE %LONG  0x00000000 ; APBDEV_PMC_VDDP_SEL_0
D.S SD:0x7000E4E8 %LE %LONG  0x00000003 ; APBDEV_PMC_DDR_PWR_0
D.S SD:0x7000E5D0 %LE %LONG  0x000000C4 ; APBDEV_PMC_DDR_CFG_0
D.S SD:0x7000E5D4 %LE %LONG  0x00000000 ; APBDEV_PMC_E_NO_VTTGEN_0
D.S SD:0x7000E444 %LE %LONG  0x00000000 ; APBDEV_PMC_NO_IOPOWER_0
D.S SD:0x7000E5B8 %LE %LONG  0x82800000 ; APBDEV_PMC_IO_DPD_REQ_0
D.S SD:0x7000E5C0 %LE %LONG  0x80110000 ; APBDEV_PMC_IO_DPD2_REQ_0
D.S SD:0x7000E6CC %LE %LONG  0x00000000 ; APBDEV_PMC_
D.S SD:0x60006014 %LE %LONG  0xFFDDFFF7 ; CLK_RST_CONTROLLER_CLK_OUT_ENB_H_0
D.S SD:0x60006364 %LE %LONG  0xDF7FBFFD ; CLK_RST_CONTROLLER_CLK_OUT_ENB_W_0
D.S SD:0x60006008 %LE %LONG  0x00000000 ; CLK_RST_CONTROLLER_RST_DEVICES_H_0
D.S SD:0x6000635C %LE %LONG  0x00000000 ; CLK_RST_CONTROLLER_RST_DEVICES_W_0
D.S SD:0x7001A488 %LE %LONG  0xFFFF0FFF ; EMC_ADDR_SWIZZLE_STACK1A_1
D.S SD:0x7001A48C %LE %LONG  0x000FFFFF ; EMC_ADDR_SWIZZLE_STACK1B_1
D.S SD:0x7001A490 %LE %LONG  0x06543210 ; EMC_ADDR_SWIZZLE_STACK2A_1
D.S SD:0x7001A494 %LE %LONG  0x00000987 ; EMC_ADDR_SWIZZLE_STACK2B_1
D.S SD:0x7001A498 %LE %LONG  0x00743210 ; EMC_ADDR_SWIZZLE_STACK3_1
D.S SD:0x7001A400 %LE %LONG  0x0000006C ; EMC_SWIZZLE_RANK0_BYTE_CFG_1
D.S SD:0x7001A404 %LE %LONG  0x26751304 ; EMC_SWIZZLE_RANK0_BYTE0_1
D.S SD:0x7001A408 %LE %LONG  0x76410532 ; EMC_SWIZZLE_RANK0_BYTE1_1
D.S SD:0x7001A40C %LE %LONG  0x67012534 ; EMC_SWIZZLE_RANK0_BYTE2_1
D.S SD:0x7001A410 %LE %LONG  0x23504176 ; EMC_SWIZZLE_RANK0_BYTE3_1
D.S SD:0x7001A414 %LE %LONG  0x0000006C ; EMC_SWIZZLE_RANK1_BYTE_CFG_1
D.S SD:0x7001A418 %LE %LONG  0x26751304 ; EMC_SWIZZLE_RANK1_BYTE0_1
D.S SD:0x7001A41C %LE %LONG  0x76410532 ; EMC_SWIZZLE_RANK1_BYTE1_1
D.S SD:0x7001A420 %LE %LONG  0x67012534 ; EMC_SWIZZLE_RANK1_BYTE2_1
D.S SD:0x7001A424 %LE %LONG  0x23504176 ; EMC_SWIZZLE_RANK1_BYTE3_1
D.S SD:0x7001AC88 %LE %LONG  0xFFFF0FFF ; EMC_ADDR_SWIZZLE_STACK1A_2
D.S SD:0x7001AC8C %LE %LONG  0x000FFFFF ; EMC_ADDR_SWIZZLE_STACK1B_2
D.S SD:0x7001AC90 %LE %LONG  0x06543210 ; EMC_ADDR_SWIZZLE_STACK2A_2
D.S SD:0x7001AC94 %LE %LONG  0x00000987 ; EMC_ADDR_SWIZZLE_STACK2B_2
D.S SD:0x7001AC98 %LE %LONG  0x00743210 ; EMC_ADDR_SWIZZLE_STACK3_2
D.S SD:0x7001AC00 %LE %LONG  0x000000B1 ; EMC_SWIZZLE_RANK0_BYTE_CFG_2
D.S SD:0x7001AC04 %LE %LONG  0x74350162 ; EMC_SWIZZLE_RANK0_BYTE0_2
D.S SD:0x7001AC08 %LE %LONG  0x26345071 ; EMC_SWIZZLE_RANK0_BYTE1_2
D.S SD:0x7001AC0C %LE %LONG  0x54721360 ; EMC_SWIZZLE_RANK0_BYTE2_2
D.S SD:0x7001AC10 %LE %LONG  0x76532104 ; EMC_SWIZZLE_RANK0_BYTE3_2
D.S SD:0x7001AC14 %LE %LONG  0x000000B1 ; EMC_SWIZZLE_RANK1_BYTE_CFG_2
D.S SD:0x7001AC18 %LE %LONG  0x74350162 ; EMC_SWIZZLE_RANK1_BYTE0_2
D.S SD:0x7001AC1C %LE %LONG  0x26345071 ; EMC_SWIZZLE_RANK1_BYTE1_2
D.S SD:0x7001AC20 %LE %LONG  0x54721360 ; EMC_SWIZZLE_RANK1_BYTE2_2
D.S SD:0x7001AC24 %LE %LONG  0x76532104 ; EMC_SWIZZLE_RANK1_BYTE3_2
D.S SD:0x7001B2F0 %LE %LONG  0x00111220 ; EMC_XM2CMDPADCTRL_0
D.S SD:0x7001B2F4 %LE %LONG  0x770C0000 ; EMC_XM2CMDPADCTRL2_0
D.S SD:0x7001B464 %LE %LONG  0x050C0000 ; EMC_XM2CMDPADCTRL3_0
D.S SD:0x7001B484 %LE %LONG  0x00000000 ; EMC_XM2CMDPADCTRL4_0
D.S SD:0x7001B2F8 %LE %LONG  0x770C1414 ; EMC_XM2DQSPADCTRL_0
D.S SD:0x7001B2FC %LE %LONG  0x0000A01C ; EMC_XM2DQSPADCTRL2_0
D.S SD:0x7001B0F8 %LE %LONG  0x20820800 ; EMC_XM2DQSPADCTRL3_0
D.S SD:0x7001B320 %LE %LONG  0x00208208 ; EMC_XM2DQSPADCTRL4_0
D.S SD:0x7001B300 %LE %LONG  0x770C2990 ; EMC_XM2DQPADCTRL_0
D.S SD:0x7001B304 %LE %LONG  0x00000000 ; EMC_XM2DQPADCTRL2_0
D.S SD:0x7001B308 %LE %LONG  0x77FFC004 ; EMC_XM2CLKPADCTRL_0
D.S SD:0x7001B3FC %LE %LONG  0x00000000 ; EMC_XM2CLKPADCTRL2_0
D.S SD:0x7001B30C %LE %LONG  0x81F1F008 ; EMC_XM2COMPPADCTRL_0
D.S SD:0x7001B310 %LE %LONG  0x33005500 ; EMC_XM2VTTGENPADCTRL_0
D.S SD:0x7001B314 %LE %LONG  0x0000001F ; EMC_XM2VTTGENPADCTRL2_0
D.S SD:0x7001AAF4 %LE %LONG  0x770C0000 ; EMC_XM2CMDPADCTRL2_2
D.S SD:0x7001AC64 %LE %LONG  0x050C0000 ; EMC_XM2CMDPADCTRL3_2
D.S SD:0x7001AC84 %LE %LONG  0x00000000 ; EMC_XM2CMDPADCTRL4_2
D.S SD:0x7001AAF8 %LE %LONG  0x770C1414 ; EMC_XM2DQSPADCTRL_2
D.S SD:0x7001A8F8 %LE %LONG  0x20820800 ; EMC_XM2DQSPADCTRL3_2
D.S SD:0x7001AB20 %LE %LONG  0x00208208 ; EMC_XM2DQSPADCTRL4_2
D.S SD:0x7001AB00 %LE %LONG  0x770C2990 ; EMC_XM2DQPADCTRL_2
D.S SD:0x7001AB04 %LE %LONG  0x00000000 ; EMC_XM2DQPADCTRL2_2
D.S SD:0x7001AB08 %LE %LONG  0x77FFC004 ; EMC_XM2CLKPADCTRL_2
D.S SD:0x7001ABFC %LE %LONG  0x00000000 ; EMC_XM2CLKPADCTRL2_2
D.S SD:0x7001B028 %LE %LONG  0x00000001 ; EMC_TIMING_CONTROL_0
D.S SD:0x70019648 %LE %LONG  0xFFF00000 ; MC_VIDEO_PROTECT_BOM_0
D.S SD:0x7001964C %LE %LONG  0x00000000 ; MC_VIDEO_PROTECT_SIZE_MB_0
D.S SD:0x70019418 %LE %LONG  0x009A4752 ; MC_VIDEO_PROTECT_VPR_OVERRIDE_0
D.S SD:0x70019054 %LE %LONG  0x00000000 ; MC_EMEM_ADR_CFG_0
D.S SD:0x70019058 %LE %LONG  0x00070303 ; MC_EMEM_ADR_CFG_DEV0_0
D.S SD:0x7001905C %LE %LONG  0x00070303 ; MC_EMEM_ADR_CFG_DEV1_0
D.S SD:0x70019060 %LE %LONG  0x00000640 ; MC_EMEM_ADR_CFG_CHANNEL_MASK_0
D.S SD:0x70019644 %LE %LONG  0x00000008 ; MC_EMEM_ADR_CFG_CHANNEL_MASK_PROPAGATION_COUNT_0
D.S SD:0x70019064 %LE %LONG  0x69248003 ; MC_EMEM_ADR_CFG_BANK_MASK_0_0
D.S SD:0x70019068 %LE %LONG  0x24928000 ; MC_EMEM_ADR_CFG_BANK_MASK_1_0
D.S SD:0x7001906C %LE %LONG  0x92C94C00 ; MC_EMEM_ADR_CFG_BANK_MASK_2_0
D.S SD:0x70019050 %LE %LONG  0x00000400 ; MC_EMEM_CFG_0
D.S SD:0x70019670 %LE %LONG  0xFFF00000 ; MC_SEC_CARVEOUT_BOM_0
D.S SD:0x70019674 %LE %LONG  0x00000000 ; MC_SEC_CARVEOUT_SIZE_MB_0
D.S SD:0x70019090 %LE %LONG  0x02000006 ; MC_EMEM_ARB_CFG_0
D.S SD:0x70019094 %LE %LONG  0x800000FE ; MC_EMEM_ARB_OUTSTANDING_REQ_0
D.S SD:0x70019098 %LE %LONG  0x00000004 ; MC_EMEM_ARB_TIMING_RCD_0
D.S SD:0x7001909C %LE %LONG  0x00000007 ; MC_EMEM_ARB_TIMING_RP_0
D.S SD:0x700190A0 %LE %LONG  0x00000010 ; MC_EMEM_ARB_TIMING_RC_0
D.S SD:0x700190A4 %LE %LONG  0x00000009 ; MC_EMEM_ARB_TIMING_RAS_0
D.S SD:0x700190A8 %LE %LONG  0x0000000E ; MC_EMEM_ARB_TIMING_FAW_0
D.S SD:0x700190AC %LE %LONG  0x00000004 ; MC_EMEM_ARB_TIMING_RRD_0
D.S SD:0x700190B0 %LE %LONG  0x00000006 ; MC_EMEM_ARB_TIMING_RAP2PRE_0
D.S SD:0x700190B4 %LE %LONG  0x00000013 ; MC_EMEM_ARB_TIMING_WAP2PRE_0
D.S SD:0x700190B8 %LE %LONG  0x00000009 ; MC_EMEM_ARB_TIMING_R2R_0
D.S SD:0x700190BC %LE %LONG  0x00000007 ; MC_EMEM_ARB_TIMING_W2W_0
D.S SD:0x700190C0 %LE %LONG  0x0000000F ; MC_EMEM_ARB_TIMING_R2W_0
D.S SD:0x700190C4 %LE %LONG  0x00000012 ; MC_EMEM_ARB_TIMING_W2R_0
D.S SD:0x700190D0 %LE %LONG  0x120E0709 ; MC_EMEM_ARB_DA_TURNS_0
D.S SD:0x700190D4 %LE %LONG  0x001E1110 ; MC_EMEM_ARB_DA_COVERS_0
D.S SD:0x700190D8 %LE %LONG  0x7A871311 ; MC_EMEM_ARB_MISC0_0
D.S SD:0x700190DC %LE %LONG  0x78000000 ; MC_EMEM_ARB_MISC1_0
D.S SD:0x700190E0 %LE %LONG  0x001F0001 ; MC_EMEM_ARB_RING1_THROTTLE_0
D.S SD:0x700190E8 %LE %LONG  0x00000083 ; MC_EMEM_ARB_OVERRIDE_0
D.S SD:0x700190EC %LE %LONG  0xFF00FF00 ; MC_EMEM_ARB_RSV_0
D.S SD:0x700190FC %LE %LONG  0x00000001 ; MC_TIMING_CONTROL_0
D.S SD:0x700190F4 %LE %LONG  0x00000000 ; MC_CLKEN_OVERRIDE_0
D.S SD:0x7001B010 %LE %LONG  0x00000000 ; EMC_ADR_CFG_0
D.S SD:0x7001B140 %LE %LONG  0x00000000 ; EMC_CLKEN_OVERRIDE_0
D.S SD:0x7001B2DC %LE %LONG  0x00000802 ; EMC_CTT_TERM_CTRL_0
D.S SD:0x7001B2A8 %LE %LONG  0x001FFFFF ; EMC_AUTO_CAL_INTERVAL_0
D.S SD:0x7001A458 %LE %LONG  0x00000000 ; EMC_AUTO_CAL_CONFIG2_1
D.S SD:0x7001A45C %LE %LONG  0x00000000 ; EMC_AUTO_CAL_CONFIG3_1
D.S SD:0x7001A2A4 %LE %LONG  0xA0F10000 ; EMC_AUTO_CAL_CONFIG_1
D.S SD:0x7001AC58 %LE %LONG  0x00000000 ; EMC_AUTO_CAL_CONFIG2_2
D.S SD:0x7001AC5C %LE %LONG  0x00000000 ; EMC_AUTO_CAL_CONFIG3_2
D.S SD:0x7001AAA4 %LE %LONG  0xA8F10000 ; EMC_AUTO_CAL_CONFIG_2
D.S SD:0x7001B2B8 %LE %LONG  0x000008C3 ; EMC_CFG_2_0
D.S SD:0x7001B008 %LE %LONG  0x01000400 ; EMC_DBG_0
D.S SD:0x7001B0F0 %LE %LONG  0x10004408 ; EMC_CMDQ_0
D.S SD:0x7001B0F4 %LE %LONG  0x06000404 ; EMC_MC2EMCQ_0
D.S SD:0x7001B0C8 %LE %LONG  0x00130013 ; EMC_MRS_WAIT_CNT_0
D.S SD:0x7001B0C4 %LE %LONG  0x00130013 ; EMC_MRS_WAIT_CNT2_0
D.S SD:0x7001B104 %LE %LONG  0x0001AA86 ; EMC_FBIO_CFG5_0
D.S SD:0x7001B02C %LE %LONG  0x0000000E ; EMC_RC_0
D.S SD:0x7001B030 %LE %LONG  0x00000024 ; EMC_RFC_0
D.S SD:0x7001B0C0 %LE %LONG  0x0000000A ; EMC_RFC_SLR_0
D.S SD:0x7001B034 %LE %LONG  0x0000000A ; EMC_RAS_0
D.S SD:0x7001B038 %LE %LONG  0x00000005 ; EMC_RP_0
D.S SD:0x7001B144 %LE %LONG  0x00000000 ; EMC_R2R_0
D.S SD:0x7001B148 %LE %LONG  0x00000000 ; EMC_W2W_0
D.S SD:0x7001B03C %LE %LONG  0x0000000A ; EMC_R2W_0
D.S SD:0x7001B040 %LE %LONG  0x0000000A ; EMC_W2R_0
D.S SD:0x7001B044 %LE %LONG  0x00000005 ; EMC_R2P_0
D.S SD:0x7001B048 %LE %LONG  0x0000000C ; EMC_W2P_0
D.S SD:0x7001B04C %LE %LONG  0x00000005 ; EMC_RD_RCD_0
D.S SD:0x7001B050 %LE %LONG  0x00000005 ; EMC_WR_RCD_0
D.S SD:0x7001B054 %LE %LONG  0x00000004 ; EMC_RRD_0
D.S SD:0x7001B058 %LE %LONG  0x00000004 ; EMC_REXT_0
D.S SD:0x7001B0B8 %LE %LONG  0x00000002 ; EMC_WEXT_0
D.S SD:0x7001B05C %LE %LONG  0x00000003 ; EMC_WDV_0
D.S SD:0x7001B2D0 %LE %LONG  0x00000003 ; EMC_WDV_MASK_0
D.S SD:0x7001B060 %LE %LONG  0x00000008 ; EMC_QUSE_0
D.S SD:0x7001B468 %LE %LONG  0x00000005 ; EMC_IBDLY_0
D.S SD:0x7001B14C %LE %LONG  0x00000005 ; EMC_EINPUT_0
D.S SD:0x7001B150 %LE %LONG  0x00000004 ; EMC_EINPUT_DURATION_0
D.S SD:0x7001B154 %LE %LONG  0x00010000 ; EMC_PUTERM_EXTRA_0
D.S SD:0x7001B3F4 %LE %LONG  0x00000000 ; EMC_CDB_CNTL_1_0
D.S SD:0x7001B3F8 %LE %LONG  0x00000000 ; EMC_CDB_CNTL_2_0
D.S SD:0x7001B064 %LE %LONG  0x00000004 ; EMC_QRST_0
D.S SD:0x7001B068 %LE %LONG  0x0000000C ; EMC_QSAFE_0
D.S SD:0x7001B06C %LE %LONG  0x0000000E ; EMC_RDV_0
D.S SD:0x7001B2CC %LE %LONG  0x0000000E ; EMC_RDV_MASK_0
D.S SD:0x7001B0BC %LE %LONG  0x00000000 ; EMC_CTT_0
D.S SD:0x7001B2D8 %LE %LONG  0x00000000 ; EMC_CTT_DURATION_0
D.S SD:0x7001B070 %LE %LONG  0x0000029F ; EMC_REFRESH_0
D.S SD:0x7001B074 %LE %LONG  0x00000000 ; EMC_BURST_REFRESH_NUM_0
D.S SD:0x7001B3DC %LE %LONG  0x000000C0 ; EMC_PRE_REFRESH_REQ_CNT_0
D.S SD:0x7001B078 %LE %LONG  0x00000006 ; EMC_PDEX2WR_0
D.S SD:0x7001B07C %LE %LONG  0x00000006 ; EMC_PDEX2RD_0
D.S SD:0x7001B080 %LE %LONG  0x00000007 ; EMC_PCHG2PDEN_0
D.S SD:0x7001B084 %LE %LONG  0x00000004 ; EMC_ACT2PDEN_0
D.S SD:0x7001B088 %LE %LONG  0x00000005 ; EMC_AR2PDEN_0
D.S SD:0x7001B08C %LE %LONG  0x00000010 ; EMC_RW2PDEN_0
D.S SD:0x7001B090 %LE %LONG  0x00000027 ; EMC_TXSR_0
D.S SD:0x7001B3E4 %LE %LONG  0x00000027 ; EMC_TXSRDLL_0
D.S SD:0x7001B094 %LE %LONG  0x00000008 ; EMC_TCKE_0
D.S SD:0x7001B158 %LE %LONG  0x00000004 ; EMC_TCKESR_0
D.S SD:0x7001B15C %LE %LONG  0x00000004 ; EMC_TPD_0
D.S SD:0x7001B098 %LE %LONG  0x0000000F ; EMC_TFAW_0
D.S SD:0x7001B09C %LE %LONG  0x00000006 ; EMC_TRPAB_0
D.S SD:0x7001B0A0 %LE %LONG  0x00000003 ; EMC_TCLKSTABLE_0
D.S SD:0x7001B0A4 %LE %LONG  0x00000005 ; EMC_TCLKSTOP_0
D.S SD:0x7001B0A8 %LE %LONG  0x000003B5 ; EMC_TREFBW_0
D.S SD:0x7001B0B0 %LE %LONG  0x00000000 ; EMC_ODT_WRITE_0
D.S SD:0x7001B0B4 %LE %LONG  0x00000000 ; EMC_ODT_READ_0
D.S SD:0x7001B0AC %LE %LONG  0x00000007 ; EMC_QUSE_EXTRA_0
D.S SD:0x7001B114 %LE %LONG  0x00000004 ; EMC_FBIO_CFG6_0
D.S SD:0x7001B2BC %LE %LONG  0x00A800AC ; EMC_CFG_DIG_DLL_0
D.S SD:0x7001B2C0 %LE %LONG  0x00008000 ; EMC_CFG_DIG_DLL_PERIOD_0
D.S SD:0x7001B100 %LE %LONG  0x02000100 ; EMC_FBIO_SPARE_0
D.S SD:0x7001B120 %LE %LONG  0xFF00FF00 ; EMC_CFG_RSV_0
D.S SD:0x7001B328 %LE %LONG  0x00004010 ; EMC_DLL_XFORM_DQS0_0
D.S SD:0x7001B32C %LE %LONG  0x00004010 ; EMC_DLL_XFORM_DQS1_0
D.S SD:0x7001B330 %LE %LONG  0x00004010 ; EMC_DLL_XFORM_DQS2_0
D.S SD:0x7001B334 %LE %LONG  0x00004010 ; EMC_DLL_XFORM_DQS3_0
D.S SD:0x7001B338 %LE %LONG  0x00004010 ; EMC_DLL_XFORM_DQS4_0
D.S SD:0x7001B33C %LE %LONG  0x00004010 ; EMC_DLL_XFORM_DQS5_0
D.S SD:0x7001B340 %LE %LONG  0x00004010 ; EMC_DLL_XFORM_DQS6_0
D.S SD:0x7001B344 %LE %LONG  0x00004010 ; EMC_DLL_XFORM_DQS7_0
D.S SD:0x7001B348 %LE %LONG  0x00000008 ; EMC_DLL_XFORM_QUSE0_0
D.S SD:0x7001B34C %LE %LONG  0x00000008 ; EMC_DLL_XFORM_QUSE1_0
D.S SD:0x7001B350 %LE %LONG  0x00000008 ; EMC_DLL_XFORM_QUSE2_0
D.S SD:0x7001B354 %LE %LONG  0x00000008 ; EMC_DLL_XFORM_QUSE3_0
D.S SD:0x7001B358 %LE %LONG  0x00000008 ; EMC_DLL_XFORM_QUSE4_0
D.S SD:0x7001B35C %LE %LONG  0x00000008 ; EMC_DLL_XFORM_QUSE5_0
D.S SD:0x7001B360 %LE %LONG  0x00000008 ; EMC_DLL_XFORM_QUSE6_0
D.S SD:0x7001B364 %LE %LONG  0x00000008 ; EMC_DLL_XFORM_QUSE7_0
D.S SD:0x7001B368 %LE %LONG  0x00090000 ; EMC_DLL_XFORM_DQ0_0
D.S SD:0x7001B36C %LE %LONG  0x00090000 ; EMC_DLL_XFORM_DQ1_0
D.S SD:0x7001B370 %LE %LONG  0x00090000 ; EMC_DLL_XFORM_DQ2_0
D.S SD:0x7001B374 %LE %LONG  0x00090000 ; EMC_DLL_XFORM_DQ3_0
D.S SD:0x7001B46C %LE %LONG  0x00098000 ; EMC_DLL_XFORM_ADDR0_0
D.S SD:0x7001B470 %LE %LONG  0x00000000 ; EMC_DLL_XFORM_ADDR1_0
D.S SD:0x7001B474 %LE %LONG  0x00098000 ; EMC_DLL_XFORM_ADDR2_0
D.S SD:0x7001B3A8 %LE %LONG  0x00000000 ; EMC_DLI_TRIM_TXDQS0_0
D.S SD:0x7001B3AC %LE %LONG  0x00000000 ; EMC_DLI_TRIM_TXDQS1_0
D.S SD:0x7001B3B0 %LE %LONG  0x00000000 ; EMC_DLI_TRIM_TXDQS2_0
D.S SD:0x7001B3B4 %LE %LONG  0x00000000 ; EMC_DLI_TRIM_TXDQS3_0
D.S SD:0x7001B3B8 %LE %LONG  0x00000000 ; EMC_DLI_TRIM_TXDQS4_0
D.S SD:0x7001B3BC %LE %LONG  0x00000000 ; EMC_DLI_TRIM_TXDQS5_0
D.S SD:0x7001B3C0 %LE %LONG  0x00000000 ; EMC_DLI_TRIM_TXDQS6_0
D.S SD:0x7001B3C4 %LE %LONG  0x00000000 ; EMC_DLI_TRIM_TXDQS7_0
D.S SD:0x7001B124 %LE %LONG  0x00000000 ; EMC_ACPD_CONTROL_0
D.S SD:0x7001B47C %LE %LONG  0x0000003F ; EMC_DSR_VTTGEN_DRV_0
D.S SD:0x7001B480 %LE %LONG  0x00000000 ; EMC_TXDSRVTTGEN_0
D.S SD:0x7001B434 %LE %LONG  0x09257359 ; EMC_CA_TRAINING_TIMING_CNTL1_0
D.S SD:0x7001B438 %LE %LONG  0x00000017 ; EMC_CA_TRAINING_TIMING_CNTL2_0
D.S SD:0x7001AB28 %LE %LONG  0x00004010 ; EMC_DLL_XFORM_DQS0_2
D.S SD:0x7001AB2C %LE %LONG  0x00004010 ; EMC_DLL_XFORM_DQS1_2
D.S SD:0x7001AB30 %LE %LONG  0x00004010 ; EMC_DLL_XFORM_DQS2_2
D.S SD:0x7001AB34 %LE %LONG  0x00004010 ; EMC_DLL_XFORM_DQS3_2
D.S SD:0x7001AB38 %LE %LONG  0x00004010 ; EMC_DLL_XFORM_DQS4_2
D.S SD:0x7001AB3C %LE %LONG  0x00004010 ; EMC_DLL_XFORM_DQS5_2
D.S SD:0x7001AB40 %LE %LONG  0x00004010 ; EMC_DLL_XFORM_DQS6_2
D.S SD:0x7001AB44 %LE %LONG  0x00004010 ; EMC_DLL_XFORM_DQS7_2
D.S SD:0x7001AB48 %LE %LONG  0x00000008 ; EMC_DLL_XFORM_QUSE0_2
D.S SD:0x7001AB4C %LE %LONG  0x00000008 ; EMC_DLL_XFORM_QUSE1_2
D.S SD:0x7001AB50 %LE %LONG  0x00000008 ; EMC_DLL_XFORM_QUSE2_2
D.S SD:0x7001AB54 %LE %LONG  0x00000008 ; EMC_DLL_XFORM_QUSE3_2
D.S SD:0x7001AB58 %LE %LONG  0x00000008 ; EMC_DLL_XFORM_QUSE4_2
D.S SD:0x7001AB5C %LE %LONG  0x00000008 ; EMC_DLL_XFORM_QUSE5_2
D.S SD:0x7001AB60 %LE %LONG  0x00000008 ; EMC_DLL_XFORM_QUSE6_2
D.S SD:0x7001AB64 %LE %LONG  0x00000008 ; EMC_DLL_XFORM_QUSE7_2
D.S SD:0x7001ABA8 %LE %LONG  0x00000000 ; EMC_DLI_TRIM_TXDQS0_2
D.S SD:0x7001ABAC %LE %LONG  0x00000000 ; EMC_DLI_TRIM_TXDQS1_2
D.S SD:0x7001ABB0 %LE %LONG  0x00000000 ; EMC_DLI_TRIM_TXDQS2_2
D.S SD:0x7001ABB4 %LE %LONG  0x00000000 ; EMC_DLI_TRIM_TXDQS3_2
D.S SD:0x7001ABB8 %LE %LONG  0x00000000 ; EMC_DLI_TRIM_TXDQS4_2
D.S SD:0x7001ABBC %LE %LONG  0x00000000 ; EMC_DLI_TRIM_TXDQS5_2
D.S SD:0x7001ABC0 %LE %LONG  0x00000000 ; EMC_DLI_TRIM_TXDQS6_2
D.S SD:0x7001ABC4 %LE %LONG  0x00000000 ; EMC_DLI_TRIM_TXDQS7_2
D.S SD:0x7001AB68 %LE %LONG  0x00090000 ; EMC_DLL_XFORM_DQ0_2
D.S SD:0x7001AB6C %LE %LONG  0x00090000 ; EMC_DLL_XFORM_DQ1_2
D.S SD:0x7001AB70 %LE %LONG  0x00090000 ; EMC_DLL_XFORM_DQ2_2
D.S SD:0x7001AB74 %LE %LONG  0x00090000 ; EMC_DLL_XFORM_DQ3_2
D.S SD:0x7001AC6C %LE %LONG  0x00098000 ; EMC_DLL_XFORM_ADDR0_2
D.S SD:0x7001AC70 %LE %LONG  0x00000000 ; EMC_DLL_XFORM_ADDR1_2
D.S SD:0x7001AC74 %LE %LONG  0x00098000 ; EMC_DLL_XFORM_ADDR2_2
D.S SD:0x7001ABF4 %LE %LONG  0x00000000 ; EMC_CDB_CNTL_1_2
D.S SD:0x7001A900 %LE %LONG  0x02000100 ; EMC_FBIO_SPARE_2
D.S SD:0x7001B00C %LE %LONG  0x03C0000E ; EMC_CFG_0
D.S SD:0x7001B028 %LE %LONG  0x00000001 ; EMC_TIMING_CONTROL_0
D.S SD:0x7000E664 %LE %LONG  0x00000000 ; APBDEV_PMC_SCRATCH1_ECO_0
D.S SD:0x7001B024 %LE %LONG  0x00000101 ; EMC_PIN_0
D.S SD:0x7001B0DC %LE %LONG  0x80000001 ; EMC_NOP_0
D.S SD:0x7001B0D8 %LE %LONG  0x80000001 ; EMC_PRE_0
D.S SD:0x7001B0E8 %LE %LONG  0x803F0000 ; EMC_MRW_0
D.S SD:0x7001B0E8 %LE %LONG  0x800A00FF ; EMC_MRW_0
D.S SD:0x7001B134 %LE %LONG  0x80020004 ; EMC_MRW2_0
D.S SD:0x7001B0E8 %LE %LONG  0x00010083 ; EMC_MRW_0
D.S SD:0x7001B138 %LE %LONG  0x80030001 ; EMC_MRW3_0
D.S SD:0x7001B13C %LE %LONG  0x800B0000 ; EMC_MRW4_0
D.S SD:0x7001B2E0 %LE %LONG  0x00064000 ; EMC_ZCAL_INTERVAL_0
D.S SD:0x7001B2E4 %LE %LONG  0x00000017 ; EMC_ZCAL_WAIT_CNT_0
D.S SD:0x7001B2E8 %LE %LONG  0x800A0056 ; EMC_ZCAL_MRW_CMD_0
D.S SD:0x7001B028 %LE %LONG  0x00000001 ; EMC_TIMING_CONTROL_0
D.S SD:0x7001B0D4 %LE %LONG  0x80000303 ; EMC_REF_0
D.S SD:0x7001B020 %LE %LONG  0x80000002 ; EMC_REFCTRL_0
D.S SD:0x7001B3E0 %LE %LONG  0x00000713 ; EMC_DYN_SELF_REF_CONTROL_0
D.S SD:0x7001B00C %LE %LONG  0x0320000E ; EMC_CFG_0
D.S SD:0x7001B3D8 %LE %LONG  0x00000000 ; EMC_SEL_DPD_CTRL_0
D.S SD:0x7001B100 %LE %LONG  0x02000100 ; EMC_FBIO_SPARE_0
D.S SD:0x7001A900 %LE %LONG  0x02000100 ; EMC_FBIO_SPARE_2
D.S SD:0x7001B028 %LE %LONG  0x00000001 ; EMC_TIMING_CONTROL_0
D.S SD:0x6000C0E0 %LE %LONG  0x00010000 ; AHB_ARBITRATION_XBAR_CTRL_0
D.S SD:0x70019650 %LE %LONG  0x00000000 ; MC_VIDEO_PROTECT_
D.S SD:0x70019664 %LE %LONG  0x00000001 ; MC_EMEM_CFG_ACCESS_CTRL_0
D.S SD:0x70019678 %LE %LONG  0x00000000 ; MC_SEC_CARVEOUT_
D.S SD:0x7000E4A0 %LE %LONG  0x40000000 ; APBDEV_PMC_SCRATCH20_0

; Enable CoreSight CYA bits so we can see error codes:
D.S SD:0x6000C208 %LE %LONG 0x01D0008F ; SB_PFCFG_0
D.S SD:0x70019678 %LE %LONG 0x00000000 ; MC_SEC_CARVEOUT_REG_CTRL_0
