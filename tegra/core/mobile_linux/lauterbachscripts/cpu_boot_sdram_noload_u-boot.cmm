; Lauterbach TRACE32 debugger script to boot CPU on with U-Boot already present in SDRAM.

LOCAL &UBOOT_SRC_DIR

&UBOOT_SRC_DIR=os.env(UBOOT_SRC_DIR)
IF "&UBOOT_SRC_DIR"==""
(
  PRINT "Please set UBOOT_SRC_DIR to u-boot source directory"
  STOP
)

winclear

; Setup JTAG for CPU.
do &(TARGET_SOC)/&(TARGET_SOC)_cpu_jtag_setup.cmm

; This should be set to "auto" if the symbol information
; is built with the correct labeling of "arm" vs. "thumb"
; mode code areas.
;system.option.dismode.auto
system.option.dismode.access

; Tell the debugger not to access non-existent memory locations.
do physical_setup.cmm

sYmbol.RESet

;ON ERROR JUMPTO nobreak

system.mode.attach
break

nobreak:
ON ERROR
&UBOOT="&UBOOT_SRC_DIR/u-boot"
print "Loading &UBOOT symbols"

;Please refer to https://wiki.nvidia.com/wmpwiki/index.php/System_SW/U-Boot/Lauterbach-Trace32
;if the location of the code to be debugged comes after the relocation.

;By default, it is assumed that the debugging code of interest comes before relocation.

data.load.elf &UBOOT /NOCODE /GNU

;data.load.elf &UBOOT /NOCODE /GNU /RELOC .text AT 0xFFE8B000

IF "&TRANSLATE_SRC_PATH"=="TRUE"
(
  SYMBOL.SOURCEPATH.TRANSLATE "&BUILDTOP" "&TOP"
)


; Setup common toolbar items
do toolbar_setup.cmm

; Set up the DCC debug console using the SWI interface.
IF "&ENABLE_DCC_WINDOW"=="TRUE"
(
  do cpu_dcc_swi_setup.cmm
)

IF ("&LOAD_SAVED_WINDOWS"=="TRUE")
(
  ; Restore saved window configuration (this is always saved in the $T32SYS directory -- don't change the path)
  do &T32SYS/windows.cmm
)

;mode.hll

enddo

