; Lauterbach TRACE32 debugger script to boot CPU on T30 NET11 from DDR3 SDRAM.
; *************** Will work only with FPGA SYSTEMS ***************

; For NVIDIA internal use only. Customers should not use this script
; unless NVIDIA explicitly directs them to do so.


; Set supervisor mode
R.S CPSR 0x000000D3

; Blast any left over Boot Information Table (BIT) in IRAM so that the
; bootloader can properly re-initialize the chip.
D.S sd:0x40000000 %LE %LONG -1 -1 -1 -1 -1 -1 -1 -1 -1 -1 -1 -1 -1 -1 -1 -1

D.S SD:0x60006050 %LE %LONG  0x800003F1 ; CLK_RST_CONTROLLER_OSC_CTRL_0

; Initialize clock controller
; RefClk=12000000 PLLX=600000000 PLLM=533000000 PLLC=600000000 PLLP=216000000

D.S SD:0x6000609C %LE %LONG  0x00000800 ; CLK_RST_CONTROLLER_PLLM_MISC_0
D.S SD:0x600060AC %LE %LONG  0x00000800 ; CLK_RST_CONTROLLER_PLLP_MISC_0
D.S SD:0x600060CC %LE %LONG  0x00000500 ; CLK_RST_CONTROLLER_PLLU_MISC_0

D.S SD:0x60006090 %LE %LONG  0x8002150C ; CLK_RST_CONTROLLER_PLLM_BASE_0
D.S SD:0x600060A0 %LE %LONG  0x8000010C ; CLK_RST_CONTROLLER_PLLP_BASE_0
D.S SD:0x600060C0 %LE %LONG  0x8003C00C ; CLK_RST_CONTROLLER_PLLU_BASE_0

wait 50.ms

D.S SD:0x60006090 %LE %LONG  0xC002150C ; CLK_RST_CONTROLLER_PLLM_BASE_0
D.S SD:0x600060A0 %LE %LONG  0xC000010C ; CLK_RST_CONTROLLER_PLLP_BASE_0
D.S SD:0x600060C0 %LE %LONG  0xC003C00C ; CLK_RST_CONTROLLER_PLLU_BASE_0

wait 50.ms

D.S SD:0x60006090 %LE %LONG  0x4002150C ; CLK_RST_CONTROLLER_PLLM_BASE_0
D.S SD:0x600060A0 %LE %LONG  0x4000010C ; CLK_RST_CONTROLLER_PLLP_BASE_0
D.S SD:0x600060C0 %LE %LONG  0x4003C00C ; CLK_RST_CONTROLLER_PLLU_BASE_0

wait 50.ms

D.S SD:0x60006094 %LE %LONG  0x00000203 ; CLK_RST_CONTROLLER_PLLM_OUT_0

wait 50.ms

D.S SD:0x60006010 %LE %LONG  0xBFFFFFF9 ; CLK_RST_CONTROLLER_CLK_OUT_ENB_L_0
D.S SD:0x60006014 %LE %LONG  0xFEFFFEF7 ; CLK_RST_CONTROLLER_CLK_OUT_ENB_H_0
D.S SD:0x60006018 %LE %LONG  0x07F00B00 ; CLK_RST_CONTROLLER_CLK_OUT_ENB_U_0

D.S SD:0x60006020 %LE %LONG  0x20000000 ; CLK_RST_CONTROLLER_CCLK_BURST_POLICY_0
D.S SD:0x60006024 %LE %LONG  0x80000000 ; CLK_RST_CONTROLLER_SUPER_CCLK_DIVIDER_0
D.S SD:0x60006028 %LE %LONG  0x20002222 ; CLK_RST_CONTROLLER_SCLK_BURST_POLICY_0
D.S SD:0x6000602C %LE %LONG  0x80000000 ; CLK_RST_CONTROLLER_SUPER_SCLK_DIVIDER_0
D.S SD:0x60006030 %LE %LONG  0x00000010 ; CLK_RST_CONTROLLER_CLK_SYSTEM_RATE_0

D.S SD:0x6000619C %LE %LONG  0x00000000 ; CLK_RST_CONTROLLER_CLK_SOURCE_EMC_0

D.S SD:0x60006004 %LE %LONG  0x7DFFFEC1 ; CLK_RST_CONTROLLER_RST_DEVICES_L_0
D.S SD:0x60006008 %LE %LONG  0XFEFFF377 ; CLK_RST_CONTROLLER_RST_DEVICES_H_0
D.S SD:0x6000600C %LE %LONG  0X000795FF ; CLK_RST_CONTROLLER_RST_DEVICES_U_0
D.S SD:0x60006044 %LE %LONG  0x80000000 ; CLK_RST_CONTROLLER_CLK_MASK_ARM_0

; Initialize the memory controller

D.S SD:0x6000C0E0 %LE %LONG  0x00000000 ; AHB_ARBITRATION_XBAR_CTRL_0
D.S SD:0x60006308 %LE %LONG  0x02000001 ; CLK_RST_CONTROLLER_RST_DEV_H_SET_0
D.S SD:0x7000E5CC %LE %LONG  0x00000002 ; APBDEV_PMC_VDDP_SEL_0
D.S SD:0x7000E4E8 %LE %LONG  0x00000003 ; APBDEV_PMC_DDR_PWR_0
D.S SD:0x7000E5D0 %LE %LONG  0x00000002 ; APBDEV_PMC_DDR_CFG_0
D.S SD:0x7000E5D4 %LE %LONG  0x00000000 ; APBDEV_PMC_E_NO_VTTGEN_0
D.S SD:0x7000E444 %LE %LONG  0x00000000 ; APBDEV_PMC_NO_IOPOWER_0
D.S SD:0x7000E5B8 %LE %LONG  0x80000000 ; APBDEV_PMC_IO_DPD_REQ_0
D.S SD:0x6000630C %LE %LONG  0x02000001 ; CLK_RST_CONTROLLER_RST_DEV_H_CLR_0
D.S SD:0x7000F6F0 %LE %LONG  0x001402A0 ; EMC_XM2CMDPADCTRL_0
D.S SD:0x7000F6F4 %LE %LONG  0x770C0000 ; EMC_XM2CMDPADCTRL2_0
D.S SD:0x7000F6F8 %LE %LONG  0x770C1414 ; EMC_XM2DQSPADCTRL_0
D.S SD:0x7000F6FC %LE %LONG  0x0800013D ; EMC_XM2DQSPADCTRL2_0
D.S SD:0x7000F4F8 %LE %LONG  0x08000021 ; EMC_XM2DQSPADCTRL3_0
D.S SD:0x7000F700 %LE %LONG  0x770C2990 ; EMC_XM2DQPADCTRL_0
D.S SD:0x7000F704 %LE %LONG  0x00000000 ; EMC_XM2DQPADCTRL2_0
D.S SD:0x7000F708 %LE %LONG  0x77FFC084 ; EMC_XM2CLKPADCTRL_0
D.S SD:0x7000F70C %LE %LONG  0x01F1F508 ; EMC_XM2COMPPADCTRL_0
D.S SD:0x7000F710 %LE %LONG  0x07075504 ; EMC_XM2VTTGENPADCTRL_0
D.S SD:0x7000F714 %LE %LONG  0x00000007 ; EMC_XM2VTTGENPADCTRL2_0
D.S SD:0x7000F718 %LE %LONG  0x0800011D ; EMC_XM2QUSEPADCTRL_0
D.S SD:0x7000F054 %LE %LONG  0x00000001 ; MC_EMEM_ADR_CFG_0
D.S SD:0x7000F058 %LE %LONG  0x00080303 ; MC_EMEM_ADR_CFG_DEV0_0
D.S SD:0x7000F05C %LE %LONG  0x00080303 ; MC_EMEM_ADR_CFG_DEV1_0
D.S SD:0x7000F050 %LE %LONG  0x00000800 ; MC_EMEM_CFG_0
D.S SD:0x7000F090 %LE %LONG  0x00000008 ; MC_EMEM_ARB_CFG_0
D.S SD:0x7000F094 %LE %LONG  0x80000060 ; MC_EMEM_ARB_OUTSTANDING_REQ_0
D.S SD:0x7000F098 %LE %LONG  0x00000002 ; MC_EMEM_ARB_TIMING_RCD_0
D.S SD:0x7000F09C %LE %LONG  0x00000003 ; MC_EMEM_ARB_TIMING_RP_0
D.S SD:0x7000F0A0 %LE %LONG  0x0000000D ; MC_EMEM_ARB_TIMING_RC_0
D.S SD:0x7000F0A4 %LE %LONG  0x00000008 ; MC_EMEM_ARB_TIMING_RAS_0
D.S SD:0x7000F0A8 %LE %LONG  0x00000007 ; MC_EMEM_ARB_TIMING_FAW_0
D.S SD:0x7000F0AC %LE %LONG  0x00000001 ; MC_EMEM_ARB_TIMING_RRD_0
D.S SD:0x7000F0B0 %LE %LONG  0x00000002 ; MC_EMEM_ARB_TIMING_RAP2PRE_0
D.S SD:0x7000F0B4 %LE %LONG  0x00000009 ; MC_EMEM_ARB_TIMING_WAP2PRE_0
D.S SD:0x7000F0B8 %LE %LONG  0x00000002 ; MC_EMEM_ARB_TIMING_R2R_0
D.S SD:0x7000F0BC %LE %LONG  0x00000001 ; MC_EMEM_ARB_TIMING_W2W_0
D.S SD:0x7000F0C0 %LE %LONG  0x00000003 ; MC_EMEM_ARB_TIMING_R2W_0
D.S SD:0x7000F0C4 %LE %LONG  0x00000006 ; MC_EMEM_ARB_TIMING_W2R_0
D.S SD:0x7000F0D0 %LE %LONG  0x06030102 ; MC_EMEM_ARB_DA_TURNS_0
D.S SD:0x7000F0D4 %LE %LONG  0x0010090D ; MC_EMEM_ARB_DA_COVERS_0
D.S SD:0x7000F0D8 %LE %LONG  0x7028180E ; MC_EMEM_ARB_MISC0_0
D.S SD:0x7000F0DC %LE %LONG  0x78000000 ; MC_EMEM_ARB_MISC1_0
D.S SD:0x7000F0E0 %LE %LONG  0x001F0000 ; MC_EMEM_ARB_RING1_THROTTLE_0
D.S SD:0x7000F0E8 %LE %LONG  0x00000080 ; MC_EMEM_ARB_OVERRIDE_0
D.S SD:0x7000F0EC %LE %LONG  0xFF00FF00 ; MC_EMEM_ARB_RSV_0
D.S SD:0x7000F0FC %LE %LONG  0x00000001 ; MC_TIMING_CONTROL_0
D.S SD:0x7000F0F4 %LE %LONG  0x00000000 ; MC_CLKEN_OVERRIDE_0
D.S SD:0x7000F410 %LE %LONG  0x00000001 ; EMC_ADR_CFG_0
D.S SD:0x7000F540 %LE %LONG  0x00000000 ; EMC_CLKEN_OVERRIDE_0
D.S SD:0x7000F6DC %LE %LONG  0x00000802 ; EMC_CTT_TERM_CTRL_0
D.S SD:0x7000F6A8 %LE %LONG  0x00000000 ; EMC_AUTO_CAL_INTERVAL_0
D.S SD:0x7000F6A4 %LE %LONG  0xE0F11F1F ; EMC_AUTO_CAL_CONFIG_0
wait 1.ms
D.S SD:0x7000F6B8 %LE %LONG  0x00000001 ; EMC_CFG_2_0
D.S SD:0x7000F408 %LE %LONG  0x01000400 ; EMC_DBG_0
D.S SD:0x7000F4F0 %LE %LONG  0x10004408 ; EMC_CMDQ_0
D.S SD:0x7000F4F4 %LE %LONG  0x06000404 ; EMC_MC2EMCQ_0
D.S SD:0x7000F4C8 %LE %LONG  0x01AB000C ; EMC_MRS_WAIT_CNT_0
D.S SD:0x7000F504 %LE %LONG  0x00008088 ; EMC_FBIO_CFG5_0
D.S SD:0x7000F42C %LE %LONG  0x00000019 ; EMC_RC_0
D.S SD:0x7000F430 %LE %LONG  0x00000055 ; EMC_RFC_0
D.S SD:0x7000F434 %LE %LONG  0x00000012 ; EMC_RAS_0
D.S SD:0x7000F438 %LE %LONG  0x00000007 ; EMC_RP_0
D.S SD:0x7000F43C %LE %LONG  0x00000004 ; EMC_R2W_0
D.S SD:0x7000F440 %LE %LONG  0x0000000A ; EMC_W2R_0
D.S SD:0x7000F444 %LE %LONG  0x00000003 ; EMC_R2P_0
D.S SD:0x7000F448 %LE %LONG  0x0000000E ; EMC_W2P_0
D.S SD:0x7000F44C %LE %LONG  0x00000007 ; EMC_RD_RCD_0
D.S SD:0x7000F450 %LE %LONG  0x00000007 ; EMC_WR_RCD_0
D.S SD:0x7000F454 %LE %LONG  0x00000003 ; EMC_RRD_0
D.S SD:0x7000F458 %LE %LONG  0x00000001 ; EMC_REXT_0
D.S SD:0x7000F4B8 %LE %LONG  0x00000000 ; EMC_WEXT_0
D.S SD:0x7000F45C %LE %LONG  0x00000005 ; EMC_WDV_0
D.S SD:0x7000F460 %LE %LONG  0x00000006 ; EMC_QUSE_0
D.S SD:0x7000F464 %LE %LONG  0x00000006 ; EMC_QRST_0
D.S SD:0x7000F468 %LE %LONG  0x00000009 ; EMC_QSAFE_0
D.S SD:0x7000F46C %LE %LONG  0x0000000F ; EMC_RDV_0
D.S SD:0x7000F4BC %LE %LONG  0x00000000 ; EMC_CTT_0
D.S SD:0x7000F6D8 %LE %LONG  0x00000000 ; EMC_CTT_DURATION_0
D.S SD:0x7000F470 %LE %LONG  0x00000FFD ; EMC_REFRESH_0
D.S SD:0x7000F474 %LE %LONG  0x00000000 ; EMC_BURST_REFRESH_NUM_0
D.S SD:0x7000F7DC %LE %LONG  0x000003FF ; EMC_PRE_REFRESH_REQ_CNT_0
D.S SD:0x7000F478 %LE %LONG  0x00000003 ; EMC_PDEX2WR_0
D.S SD:0x7000F47C %LE %LONG  0x00000003 ; EMC_PDEX2RD_0
D.S SD:0x7000F480 %LE %LONG  0x00000001 ; EMC_PCHG2PDEN_0
D.S SD:0x7000F484 %LE %LONG  0x00000000 ; EMC_ACT2PDEN_0
D.S SD:0x7000F488 %LE %LONG  0x0000000A ; EMC_AR2PDEN_0
D.S SD:0x7000F48C %LE %LONG  0x00000012 ; EMC_RW2PDEN_0
D.S SD:0x7000F490 %LE %LONG  0x0000005B ; EMC_TXSR_0
D.S SD:0x7000F7E4 %LE %LONG  0x00000200 ; EMC_TXSRDLL_0
D.S SD:0x7000F494 %LE %LONG  0x00000004 ; EMC_TCKE_0
D.S SD:0x7000F498 %LE %LONG  0x00000010 ; EMC_TFAW_0
D.S SD:0x7000F49C %LE %LONG  0x00000000 ; EMC_TRPAB_0
D.S SD:0x7000F4A0 %LE %LONG  0x00000005 ; EMC_TCLKSTABLE_0
D.S SD:0x7000F4A4 %LE %LONG  0x00000006 ; EMC_TCLKSTOP_0
D.S SD:0x7000F4A8 %LE %LONG  0x0000103E ; EMC_TREFBW_0
D.S SD:0x7000F4B0 %LE %LONG  0x80000003 ; EMC_ODT_WRITE_0
D.S SD:0x7000F4B4 %LE %LONG  0x80000000 ; EMC_ODT_READ_0
D.S SD:0x7000F4AC %LE %LONG  0x00000000 ; EMC_QUSE_EXTRA_0
D.S SD:0x7000F514 %LE %LONG  0x00000004 ; EMC_FBIO_CFG6_0
D.S SD:0x7000F6BC %LE %LONG  0xF02C0401 ; EMC_CFG_DIG_DLL_0
D.S SD:0x7000F6C0 %LE %LONG  0x00008000 ; EMC_CFG_DIG_DLL_PERIOD_0
D.S SD:0x7000F500 %LE %LONG  0x00000000 ; EMC_FBIO_SPARE_0
D.S SD:0x7000F520 %LE %LONG  0xFF00FF00 ; EMC_CFG_RSV_0
D.S SD:0x7000F728 %LE %LONG  0x00028000 ; EMC_DLL_XFORM_DQS0_0
D.S SD:0x7000F72C %LE %LONG  0x00028000 ; EMC_DLL_XFORM_DQS1_0
D.S SD:0x7000F730 %LE %LONG  0x00028000 ; EMC_DLL_XFORM_DQS2_0
D.S SD:0x7000F734 %LE %LONG  0x00028000 ; EMC_DLL_XFORM_DQS3_0
D.S SD:0x7000F738 %LE %LONG  0x00028000 ; EMC_DLL_XFORM_DQS4_0
D.S SD:0x7000F73C %LE %LONG  0x00028000 ; EMC_DLL_XFORM_DQS5_0
D.S SD:0x7000F740 %LE %LONG  0x00028000 ; EMC_DLL_XFORM_DQS6_0
D.S SD:0x7000F744 %LE %LONG  0x00028000 ; EMC_DLL_XFORM_DQS7_0
D.S SD:0x7000F748 %LE %LONG  0x00000008 ; EMC_DLL_XFORM_QUSE0_0
D.S SD:0x7000F74C %LE %LONG  0x00000008 ; EMC_DLL_XFORM_QUSE1_0
D.S SD:0x7000F750 %LE %LONG  0x00000008 ; EMC_DLL_XFORM_QUSE2_0
D.S SD:0x7000F754 %LE %LONG  0x00000008 ; EMC_DLL_XFORM_QUSE3_0
D.S SD:0x7000F758 %LE %LONG  0x00000008 ; EMC_DLL_XFORM_QUSE4_0
D.S SD:0x7000F75C %LE %LONG  0x00000008 ; EMC_DLL_XFORM_QUSE5_0
D.S SD:0x7000F760 %LE %LONG  0x00000008 ; EMC_DLL_XFORM_QUSE6_0
D.S SD:0x7000F764 %LE %LONG  0x00000008 ; EMC_DLL_XFORM_QUSE7_0
D.S SD:0x7000F768 %LE %LONG  0x0000400C ; EMC_DLL_XFORM_DQ0_0
D.S SD:0x7000F76C %LE %LONG  0x0000400C ; EMC_DLL_XFORM_DQ1_0
D.S SD:0x7000F770 %LE %LONG  0x0000400C ; EMC_DLL_XFORM_DQ2_0
D.S SD:0x7000F774 %LE %LONG  0x0000400C ; EMC_DLL_XFORM_DQ3_0
D.S SD:0x7000F7A8 %LE %LONG  0x00000000 ; EMC_DLI_TRIM_TXDQS0_0
D.S SD:0x7000F7AC %LE %LONG  0x00000000 ; EMC_DLI_TRIM_TXDQS1_0
D.S SD:0x7000F7B0 %LE %LONG  0x00000000 ; EMC_DLI_TRIM_TXDQS2_0
D.S SD:0x7000F7B4 %LE %LONG  0x00000000 ; EMC_DLI_TRIM_TXDQS3_0
D.S SD:0x7000F7B8 %LE %LONG  0x00000000 ; EMC_DLI_TRIM_TXDQS4_0
D.S SD:0x7000F7BC %LE %LONG  0x00000000 ; EMC_DLI_TRIM_TXDQS5_0
D.S SD:0x7000F7C0 %LE %LONG  0x00000000 ; EMC_DLI_TRIM_TXDQS6_0
D.S SD:0x7000F7C4 %LE %LONG  0x00000000 ; EMC_DLI_TRIM_TXDQS7_0
D.S SD:0x7000F428 %LE %LONG  0x00000001 ; EMC_TIMING_CONTROL_0
wait 1.ms
D.S SD:0x7000F424 %LE %LONG  0x00000000 ; EMC_PIN_0
wait 1.ms
D.S SD:0x7000F424 %LE %LONG  0x00000100 ; EMC_PIN_0
wait 1.ms
D.S SD:0x7000F424 %LE %LONG  0x00000101 ; EMC_PIN_0
wait 1.ms
D.S SD:0x7000F4DC %LE %LONG  0x00000001 ; EMC_NOP_0
D.S SD:0x7000F4D0 %LE %LONG  0x00200408 ; EMC_EMRS_0
D.S SD:0x7000F4D0 %LE %LONG  0x00300000 ; EMC_EMRS_0
D.S SD:0x7000F4D0 %LE %LONG  0x00100042 ; EMC_EMRS_0
D.S SD:0x7000F4CC %LE %LONG  0x00001941 ; EMC_MRS_0
D.S SD:0x7000F6EC %LE %LONG  0x80000011 ; EMC_ZQ_CAL_0
wait 1.ms
D.S SD:0x7000F6EC %LE %LONG  0x40000011 ; EMC_ZQ_CAL_0
wait 1.ms
D.S SD:0x7000F6E0 %LE %LONG  0x00000000 ; EMC_ZCAL_INTERVAL_0
D.S SD:0x7000F6E4 %LE %LONG  0x00000040 ; EMC_ZCAL_WAIT_CNT_0
D.S SD:0x7000F6E8 %LE %LONG  0x00000000 ; EMC_ZCAL_MRW_CMD_0
D.S SD:0x7000F428 %LE %LONG  0x00000001 ; EMC_TIMING_CONTROL_0
D.S SD:0x7000F4D4 %LE %LONG  0x00000303 ; EMC_REF_0
D.S SD:0x7000F420 %LE %LONG  0x80000000 ; EMC_REFCTRL_0
D.S SD:0x7000F7E0 %LE %LONG  0x000020AE ; EMC_DYN_SELF_REF_CONTROL_0
D.S SD:0x7000F40C %LE %LONG  0x03C00000 ; EMC_CFG_0
D.S SD:0x7000F7D8 %LE %LONG  0x0004032C ; EMC_SEL_DPD_CTRL_0
D.S SD:0x7000F428 %LE %LONG  0x00000001 ; EMC_TIMING_CONTROL_0
D.S SD:0x6000C0E0 %LE %LONG  0x00010000 ; AHB_ARBITRATION_XBAR_CTRL_0
D.S SD:0x70000024 %LE %LONG  0x000000C0 ; APB_MISC_PP_CONFIG_CTL_0

; Enable CoreSight CYA bits so we can see error codes:
D.S SD:0x6000C208 %LE %LONG  0x01D0008F ; SB_PFCFG_0

D.S SD:0x7000E4A0 %LE %LONG  0x80000000 ; APBDEV_PMC_SCRATCH20_0
enddo

