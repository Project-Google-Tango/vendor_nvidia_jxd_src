; Copyright (c) 2012, NVIDIA CORPORATION.  All rights reserved.
; For NVIDIA internal use only. Customers should not use this script
; unless NVIDIA explicitly directs them to do so.

; PLLM will be overrided by cfg file, New FREQ=300
; RefClk=12000000 PLLX=800000000 PLLM=300000000 PLLC=600000000 PLLP=216000000
D.S SD:0x60006050  %LE %LONG  0x800003F1 ; CLK_RST_CONTROLLER_OSC_CTRL_0
D.S SD:0x60006050  %LE %LONG  0x800003F1 ; CLK_RST_CONTROLLER_OSC_CTRL_0
D.S SD:0x60005014  %LE %LONG  0x0000000B ; TIMERUS_USEC_CFG_0
D.S SD:0x6000F100  %LE %LONG  0x40040000 ; EVP_CPU_RESET_VECTOR_0
D.S SD:0x6000702C  %LE %LONG  0x00000001 ; FLOW_CTLR_CLUSTER_CONTROL_0
D.S SD:0x600060DC  %LE %LONG  0x00800800 ; CLK_RST_CONTROLLER_PLLD_MISC_0
D.S SD:0x600060DC  %LE %LONG  0x00000800 ; CLK_RST_CONTROLLER_PLLD_MISC_0
D.S SD:0x600064BC  %LE %LONG  0x00800800 ; CLK_RST_CONTROLLER_PLLD2_MISC_0
D.S SD:0x600064BC  %LE %LONG  0x00000800 ; CLK_RST_CONTROLLER_PLLD2_MISC_0
D.S SD:0x600060AC  %LE %LONG  0x00040800 ; CLK_RST_CONTROLLER_PLLP_MISC_0
D.S SD:0x6000608C  %LE %LONG  0x00000800 ; CLK_RST_CONTROLLER_PLLC_MISC_0
D.S SD:0x6000609C  %LE %LONG  0x00100800 ; CLK_RST_CONTROLLER_PLLM_MISC_0
D.S SD:0x600060DC  %LE %LONG  0x40000800 ; CLK_RST_CONTROLLER_PLLD_MISC_0
D.S SD:0x600064BC  %LE %LONG  0x40000800 ; CLK_RST_CONTROLLER_PLLD2_MISC_0
D.S SD:0x600060CC  %LE %LONG  0x00000500 ; CLK_RST_CONTROLLER_PLLU_MISC_0
D.S SD:0x600060E4  %LE %LONG  0x00040100 ; CLK_RST_CONTROLLER_PLLX_MISC_0
D.S SD:0x600060A0  %LE %LONG  0x9001980C ; CLK_RST_CONTROLLER_PLLP_BASE_0
D.S SD:0x600060A0  %LE %LONG  0xD001980C ; CLK_RST_CONTROLLER_PLLP_BASE_0
wait 100.ms
D.S SD:0x60006080  %LE %LONG  0x8002580C ; CLK_RST_CONTROLLER_PLLC_BASE_0
D.S SD:0x60006080  %LE %LONG  0xC002580C ; CLK_RST_CONTROLLER_PLLC_BASE_0
wait 100.ms
D.S SD:0x600060E0  %LE %LONG  0x8003200C ; CLK_RST_CONTROLLER_PLLX_BASE_0
D.S SD:0x600060E0  %LE %LONG  0xC003200C ; CLK_RST_CONTROLLER_PLLX_BASE_0
wait 100.ms
D.S SD:0x60006090  %LE %LONG  0x80012C0C ; CLK_RST_CONTROLLER_PLLM_BASE_0
D.S SD:0x60006090  %LE %LONG  0xC0012C0C ; CLK_RST_CONTROLLER_PLLM_BASE_0
wait 100.ms
D.S SD:0x600060C0  %LE %LONG  0x8003C00C ; CLK_RST_CONTROLLER_PLLU_BASE_0
D.S SD:0x600060C0  %LE %LONG  0xC003C00C ; CLK_RST_CONTROLLER_PLLU_BASE_0
wait 100.ms
D.S SD:0x600060D0  %LE %LONG  0x8002520C ; CLK_RST_CONTROLLER_PLLD_BASE_0
D.S SD:0x600060D0  %LE %LONG  0xC002520C ; CLK_RST_CONTROLLER_PLLD_BASE_0
wait 100.ms
D.S SD:0x600060DC  %LE %LONG  0x40000800 ; CLK_RST_CONTROLLER_PLLD_MISC_0
D.S SD:0x600064B8  %LE %LONG  0x8002520C ; CLK_RST_CONTROLLER_PLLD2_BASE_0
D.S SD:0x600064B8  %LE %LONG  0xC002520C ; CLK_RST_CONTROLLER_PLLD2_BASE_0
wait 100.ms
wait 100.ms
D.S SD:0x600060A0  %LE %LONG  0xD001980C ; CLK_RST_CONTROLLER_PLLP_BASE_0
D.S SD:0x60006080  %LE %LONG  0xC002580C ; CLK_RST_CONTROLLER_PLLC_BASE_0
D.S SD:0x600060E0  %LE %LONG  0xC003200C ; CLK_RST_CONTROLLER_PLLX_BASE_0
D.S SD:0x60006090  %LE %LONG  0xC0012C0C ; CLK_RST_CONTROLLER_PLLM_BASE_0
D.S SD:0x600060D0  %LE %LONG  0xC002520C ; CLK_RST_CONTROLLER_PLLD_BASE_0
D.S SD:0x600064B8  %LE %LONG  0xC002520C ; CLK_RST_CONTROLLER_PLLD2_BASE_0
D.S SD:0x600060C0  %LE %LONG  0xC003C00C ; CLK_RST_CONTROLLER_PLLU_BASE_0
D.S SD:0x600060A0  %LE %LONG  0xD001980C ; CLK_RST_CONTROLLER_PLLP_BASE_0
D.S SD:0x60006080  %LE %LONG  0xC002580C ; CLK_RST_CONTROLLER_PLLC_BASE_0
D.S SD:0x600060E0  %LE %LONG  0xC003200C ; CLK_RST_CONTROLLER_PLLX_BASE_0
D.S SD:0x60006090  %LE %LONG  0xC0012C0C ; CLK_RST_CONTROLLER_PLLM_BASE_0
D.S SD:0x600060D0  %LE %LONG  0xC002520C ; CLK_RST_CONTROLLER_PLLD_BASE_0
D.S SD:0x600064B8  %LE %LONG  0xC002520C ; CLK_RST_CONTROLLER_PLLD2_BASE_0
D.S SD:0x600060C0  %LE %LONG  0xC003C00C ; CLK_RST_CONTROLLER_PLLU_BASE_0
wait 100.ms
D.S SD:0x600060A0  %LE %LONG  0x5001980C ; CLK_RST_CONTROLLER_PLLP_BASE_0
D.S SD:0x60006080  %LE %LONG  0x4002580C ; CLK_RST_CONTROLLER_PLLC_BASE_0
D.S SD:0x600060E0  %LE %LONG  0x4003200C ; CLK_RST_CONTROLLER_PLLX_BASE_0
D.S SD:0x60006090  %LE %LONG  0x40012C0C ; CLK_RST_CONTROLLER_PLLM_BASE_0
D.S SD:0x600060D0  %LE %LONG  0x4002520C ; CLK_RST_CONTROLLER_PLLD_BASE_0
D.S SD:0x600064B8  %LE %LONG  0x4002520C ; CLK_RST_CONTROLLER_PLLD2_BASE_0
D.S SD:0x600060C0  %LE %LONG  0x4003C00C ; CLK_RST_CONTROLLER_PLLU_BASE_0
D.S SD:0x600060A4  %LE %LONG  0x00030003 ; CLK_RST_CONTROLLER_PLLP_OUTA_0
D.S SD:0x600060A4  %LE %LONG  0x00030003 ; CLK_RST_CONTROLLER_PLLP_OUTA_0
D.S SD:0x600060A8  %LE %LONG  0x00030003 ; CLK_RST_CONTROLLER_PLLP_OUTB_0
D.S SD:0x600060A8  %LE %LONG  0x00030003 ; CLK_RST_CONTROLLER_PLLP_OUTB_0
D.S SD:0x600060A4  %LE %LONG  0x00030F03 ; CLK_RST_CONTROLLER_PLLP_OUTA_0
D.S SD:0x600060A4  %LE %LONG  0x00030F07 ; CLK_RST_CONTROLLER_PLLP_OUTA_0
D.S SD:0x600060A4  %LE %LONG  0x53030F07 ; CLK_RST_CONTROLLER_PLLP_OUTA_0
D.S SD:0x600060A4  %LE %LONG  0x53070F07 ; CLK_RST_CONTROLLER_PLLP_OUTA_0
D.S SD:0x600060A8  %LE %LONG  0x00030603 ; CLK_RST_CONTROLLER_PLLP_OUTB_0
D.S SD:0x600060A8  %LE %LONG  0x00030607 ; CLK_RST_CONTROLLER_PLLP_OUTB_0
D.S SD:0x600060A8  %LE %LONG  0x06030607 ; CLK_RST_CONTROLLER_PLLP_OUTB_0
D.S SD:0x600060A8  %LE %LONG  0x06070607 ; CLK_RST_CONTROLLER_PLLP_OUTB_0
D.S SD:0x600060B0  %LE %LONG  0x8000010C ; CLK_RST_CONTROLLER_PLLA_BASE_0
D.S SD:0x600060B0  %LE %LONG  0x8041F31B ; CLK_RST_CONTROLLER_PLLA_BASE_0
D.S SD:0x600060B0  %LE %LONG  0xC041F31B ; CLK_RST_CONTROLLER_PLLA_BASE_0
wait 100.ms
D.S SD:0x600060B0  %LE %LONG  0x4041F31B ; CLK_RST_CONTROLLER_PLLA_BASE_0
wait 100.ms
D.S SD:0x600060B0  %LE %LONG  0x4041F31B ; CLK_RST_CONTROLLER_PLLA_BASE_0
D.S SD:0x60006084  %LE %LONG  0x00000603 ; CLK_RST_CONTROLLER_PLLC_OUT_0
D.S SD:0x60006094  %LE %LONG  0x00000203 ; CLK_RST_CONTROLLER_PLLM_OUT_0
D.S SD:0x60006010  %LE %LONG  0xFDFFFFF0 ; CLK_RST_CONTROLLER_CLK_OUT_ENB_L_0
D.S SD:0x60006014  %LE %LONG  0xFEFFF7F7 ; CLK_RST_CONTROLLER_CLK_OUT_ENB_H_0
D.S SD:0x60006018  %LE %LONG  0x75F79BFF ; CLK_RST_CONTROLLER_CLK_OUT_ENB_U_0
D.S SD:0x60006360  %LE %LONG  0xDFFF7FFF ; CLK_RST_CONTROLLER_CLK_OUT_ENB_V_0
D.S SD:0x60006364  %LE %LONG  0x00003FFE ; CLK_RST_CONTROLLER_CLK_OUT_ENB_W_0
wait 100.ms
D.S SD:0x60006004  %LE %LONG  0x00000001 ; CLK_RST_CONTROLLER_RST_DEVICES_L_0
D.S SD:0x60006008  %LE %LONG  0x01000858 ; CLK_RST_CONTROLLER_RST_DEVICES_H_0
D.S SD:0x6000600C  %LE %LONG  0xFFF86000 ; CLK_RST_CONTROLLER_RST_DEVICES_U_0
D.S SD:0x60006358  %LE %LONG  0x007E0003 ; CLK_RST_CONTROLLER_RST_DEVICES_V_0
D.S SD:0x6000635C  %LE %LONG  0xFFFFC000 ; CLK_RST_CONTROLLER_RST_DEVICES_W_0
D.S SD:0x60006020  %LE %LONG  0x20001111 ; CLK_RST_CONTROLLER_CCLK_BURST_POLICY_0
D.S SD:0x60006024  %LE %LONG  0x80000000 ; CLK_RST_CONTROLLER_SUPER_CCLK_DIVIDER_0
D.S SD:0x6000602C  %LE %LONG  0x80000000 ; CLK_RST_CONTROLLER_SUPER_SCLK_DIVIDER_0
D.S SD:0x60006028  %LE %LONG  0x20001111 ; CLK_RST_CONTROLLER_SCLK_BURST_POLICY_0
wait 100.ms
D.S SD:0x60006030  %LE %LONG  0x00000000 ; CLK_RST_CONTROLLER_CLK_SYSTEM_RATE_0
D.S SD:0x6000619C  %LE %LONG  0x00000000 ; CLK_RST_CONTROLLER_CLK_SOURCE_EMC_0
D.S SD:0x600061D0  %LE %LONG  0x0000000A ; CLK_RST_CONTROLLER_CLK_SOURCE_NOR_0
D.S SD:0x60006138  %LE %LONG  0x40000000 ; CLK_RST_CONTROLLER_CLK_SOURCE_DISP1_0
D.S SD:0x6000613C  %LE %LONG  0x40000000 ; CLK_RST_CONTROLLER_CLK_SOURCE_DISP2_0
D.S SD:0x600061D8  %LE %LONG  0x90000002 ; CLK_RST_CONTROLLER_CLK_SOURCE_I2S0_0
D.S SD:0x60006100  %LE %LONG  0x90000002 ; CLK_RST_CONTROLLER_CLK_SOURCE_I2S1_0
D.S SD:0x60006104  %LE %LONG  0x90000002 ; CLK_RST_CONTROLLER_CLK_SOURCE_I2S2_0
D.S SD:0x600063BC  %LE %LONG  0x90000002 ; CLK_RST_CONTROLLER_CLK_SOURCE_I2S3_0
D.S SD:0x600063C0  %LE %LONG  0x90000002 ; CLK_RST_CONTROLLER_CLK_SOURCE_I2S4_0
D.S SD:0x60006134  %LE %LONG  0x00000002 ; CLK_RST_CONTROLLER_CLK_SOURCE_SBC1_0
D.S SD:0x60006118  %LE %LONG  0x00000002 ; CLK_RST_CONTROLLER_CLK_SOURCE_SBC2_0
D.S SD:0x6000611C  %LE %LONG  0x00000002 ; CLK_RST_CONTROLLER_CLK_SOURCE_SBC3_0
D.S SD:0x600061B4  %LE %LONG  0x00000002 ; CLK_RST_CONTROLLER_CLK_SOURCE_SBC4_0
D.S SD:0x600063C8  %LE %LONG  0x00000002 ; CLK_RST_CONTROLLER_CLK_SOURCE_SBC5_0
D.S SD:0x600063CC  %LE %LONG  0x00000002 ; CLK_RST_CONTROLLER_CLK_SOURCE_SBC6_0
D.S SD:0x60006124  %LE %LONG  0x00000008 ; CLK_RST_CONTROLLER_CLK_SOURCE_I2C1_0
D.S SD:0x60006198  %LE %LONG  0x00000008 ; CLK_RST_CONTROLLER_CLK_SOURCE_I2C2_0
D.S SD:0x600061B8  %LE %LONG  0x00000008 ; CLK_RST_CONTROLLER_CLK_SOURCE_I2C3_0
D.S SD:0x600063C4  %LE %LONG  0x00000008 ; CLK_RST_CONTROLLER_CLK_SOURCE_I2C4_0
D.S SD:0x60006128  %LE %LONG  0x00000008 ; CLK_RST_CONTROLLER_CLK_SOURCE_DVC_I2C_0
D.S SD:0x60006150  %LE %LONG  0x00000010 ; CLK_RST_CONTROLLER_CLK_SOURCE_SDMMC1_0
D.S SD:0x60006154  %LE %LONG  0x00000010 ; CLK_RST_CONTROLLER_CLK_SOURCE_SDMMC2_0
D.S SD:0x600061BC  %LE %LONG  0x00000010 ; CLK_RST_CONTROLLER_CLK_SOURCE_SDMMC3_0
D.S SD:0x60006164  %LE %LONG  0x00000010 ; CLK_RST_CONTROLLER_CLK_SOURCE_SDMMC4_0
D.S SD:0x60006178  %LE %LONG  0xC0000000 ; CLK_RST_CONTROLLER_CLK_SOURCE_UARTA_0
D.S SD:0x6000617C  %LE %LONG  0xC0000000 ; CLK_RST_CONTROLLER_CLK_SOURCE_UARTB_0
D.S SD:0x600061A0  %LE %LONG  0xC0000000 ; CLK_RST_CONTROLLER_CLK_SOURCE_UARTC_0
D.S SD:0x600061C0  %LE %LONG  0xC0000000 ; CLK_RST_CONTROLLER_CLK_SOURCE_UARTD_0
D.S SD:0x600061C4  %LE %LONG  0xC0000000 ; CLK_RST_CONTROLLER_CLK_SOURCE_UARTE_0
D.S SD:0x60006140  %LE %LONG  0x00000000 ; CLK_RST_CONTROLLER_CLK_SOURCE_CVE_0
D.S SD:0x60006160  %LE %LONG  0x00000006 ; CLK_RST_CONTROLLER_CLK_SOURCE_NDFLASH_0
D.S SD:0x60006168  %LE %LONG  0xC0000000 ; CLK_RST_CONTROLLER_CLK_SOURCE_VFIR_0
D.S SD:0x60006188  %LE %LONG  0x00000000 ; CLK_RST_CONTROLLER_CLK_SOURCE_TVO_0
D.S SD:0x6000618C  %LE %LONG  0xA0000000 ; CLK_RST_CONTROLLER_CLK_SOURCE_HDMI_0
D.S SD:0x6000618C  %LE %LONG  0xA0000006 ; CLK_RST_CONTROLLER_CLK_SOURCE_HDMI_0
D.S SD:0x600063E4  %LE %LONG  0x00000007 ; CLK_RST_CONTROLLER_CLK_SOURCE_HDA2CODEC_2X_0
D.S SD:0x60006194  %LE %LONG  0x0000000E ; CLK_RST_CONTROLLER_CLK_SOURCE_TVDAC_0
D.S SD:0x60006424  %LE %LONG  0x01000002 ; CLK_RST_CONTROLLER_CLK_SOURCE_SATA_0
D.S SD:0x60006420  %LE %LONG  0x00000000 ; CLK_RST_CONTROLLER_CLK_SOURCE_SATA_OOB_0
D.S SD:0x600061D4  %LE %LONG  0x00000000 ; CLK_RST_CONTROLLER_CLK_SOURCE_CSITE_0
D.S SD:0x600061D4  %LE %LONG  0x00000000 ; CLK_RST_CONTROLLER_CLK_SOURCE_CSITE_0
wait 100.ms
D.S SD:0x600061F8  %LE %LONG  0xC0000000 ; CLK_RST_CONTROLLER_CLK_SOURCE_LA_0
D.S SD:0x60006180  %LE %LONG  0x00000000 ; CLK_RST_CONTROLLER_CLK_SOURCE_HOST1X_0
D.S SD:0x60006180  %LE %LONG  0x00000002 ; CLK_RST_CONTROLLER_CLK_SOURCE_HOST1X_0
D.S SD:0x60006158  %LE %LONG  0x40000000 ; CLK_RST_CONTROLLER_CLK_SOURCE_G3D_0
D.S SD:0x60006158  %LE %LONG  0x40000003 ; CLK_RST_CONTROLLER_CLK_SOURCE_G3D_0
D.S SD:0x600063B0  %LE %LONG  0x40000000 ; CLK_RST_CONTROLLER_CLK_SOURCE_G3D2_0
D.S SD:0x600063B0  %LE %LONG  0x40000003 ; CLK_RST_CONTROLLER_CLK_SOURCE_G3D2_0
D.S SD:0x6000615C  %LE %LONG  0x00000000 ; CLK_RST_CONTROLLER_CLK_SOURCE_G2D_0
D.S SD:0x6000615C  %LE %LONG  0x00000002 ; CLK_RST_CONTROLLER_CLK_SOURCE_G2D_0
D.S SD:0x60006148  %LE %LONG  0x00000000 ; CLK_RST_CONTROLLER_CLK_SOURCE_VI_0
D.S SD:0x60006148  %LE %LONG  0x00000002 ; CLK_RST_CONTROLLER_CLK_SOURCE_VI_0
D.S SD:0x600061A8  %LE %LONG  0x00000000 ; CLK_RST_CONTROLLER_CLK_SOURCE_VI_SENSOR_0
D.S SD:0x600061A8  %LE %LONG  0x00000017 ; CLK_RST_CONTROLLER_CLK_SOURCE_VI_SENSOR_0
D.S SD:0x6000616C  %LE %LONG  0x00000000 ; CLK_RST_CONTROLLER_CLK_SOURCE_EPP_0
D.S SD:0x6000616C  %LE %LONG  0x00000002 ; CLK_RST_CONTROLLER_CLK_SOURCE_EPP_0
D.S SD:0x600061C8  %LE %LONG  0x80000000 ; CLK_RST_CONTROLLER_CLK_SOURCE_VDE_0
D.S SD:0x600061C8  %LE %LONG  0x80000002 ; CLK_RST_CONTROLLER_CLK_SOURCE_VDE_0
D.S SD:0x60006170  %LE %LONG  0x00000000 ; CLK_RST_CONTROLLER_CLK_SOURCE_MPE_0
D.S SD:0x60006170  %LE %LONG  0x00000002 ; CLK_RST_CONTROLLER_CLK_SOURCE_MPE_0
; REFCLK  %LE %LONG  12000 khz
; File=E1186_Hynix_2GB_H5TC2G83BFR-PBA_300MHz_110306.cfg Freq=300 tclk=3.333333
D.S SD:0x6000609C  %LE %LONG  0x00000800 ; CLK_RST_CONTROLLER_PLLM_MISC_0
D.S SD:0x60006090  %LE %LONG  0x40012C0C ; CLK_RST_CONTROLLER_PLLM_BASE_0
wait 100.ms
D.S SD:0x7000E5CC  %LE %LONG  0x00000002 ; APBDEV_PMC_VDDP_SEL_0
D.S SD:0x7000E4E8  %LE %LONG  0x00000003 ; APBDEV_PMC_DDR_PWR_0
D.S SD:0x7000E5D0  %LE %LONG  0x00000002 ; APBDEV_PMC_DDR_CFG_0
D.S SD:0x7000E5D4  %LE %LONG  0x00000000 ; APBDEV_PMC_E_NO_VTTGEN_0
D.S SD:0x7000E444  %LE %LONG  0x00000000 ; APBDEV_PMC_NO_IOPOWER_0
D.S SD:0x7000E5B8  %LE %LONG  0x80000000 ; APBDEV_PMC_IO_DPD_REQ_0
D.S SD:0x60006014  %LE %LONG  0xFEFFF7F7 ; CLK_RST_CONTROLLER_CLK_OUT_ENB_H_0
wait 100.ms
D.S SD:0x60006014  %LE %LONG  0xFEFFF7F7 ; CLK_RST_CONTROLLER_CLK_OUT_ENB_H_0
wait 100.ms
D.S SD:0x60006008  %LE %LONG  0x01000858 ; CLK_RST_CONTROLLER_RST_DEVICES_H_0
wait 100.ms
D.S SD:0x60006008  %LE %LONG  0x01000858 ; CLK_RST_CONTROLLER_RST_DEVICES_H_0
wait 100.ms
D.S SD:0x6000619C  %LE %LONG  0x20000000 ; CLK_RST_CONTROLLER_CLK_SOURCE_EMC_0
D.S SD:0x7000F6F0  %LE %LONG  0x000002A0 ; EMC_XM2CMDPADCTRL_0
D.S SD:0x7000F6F4  %LE %LONG  0x770C0000 ; EMC_XM2CMDPADCTRL2_0
D.S SD:0x7000F6F8  %LE %LONG  0x770C1414 ; EMC_XM2DQSPADCTRL_0
D.S SD:0x7000F6FC  %LE %LONG  0x0800211D ; EMC_XM2DQSPADCTRL2_0
D.S SD:0x7000F4F8  %LE %LONG  0x00000000 ; EMC_XM2DQSPADCTRL3_0
D.S SD:0x7000F700  %LE %LONG  0x770C2990 ; EMC_XM2DQPADCTRL_0
D.S SD:0x7000F704  %LE %LONG  0x00000000 ; EMC_XM2DQPADCTRL2_0
D.S SD:0x7000F708  %LE %LONG  0x77FFC084 ; EMC_XM2CLKPADCTRL_0
D.S SD:0x7000F70C  %LE %LONG  0x01F1F508 ; EMC_XM2COMPPADCTRL_0
D.S SD:0x7000F710  %LE %LONG  0x07075504 ; EMC_XM2VTTGENPADCTRL_0
D.S SD:0x7000F714  %LE %LONG  0x00000007 ; EMC_XM2VTTGENPADCTRL2_0
D.S SD:0x7000F718  %LE %LONG  0x0800012D ; EMC_XM2QUSEPADCTRL_0
D.S SD:0x7000F054  %LE %LONG  0x00000001 ; MC_EMEM_ADR_CFG_0
D.S SD:0x7000F058  %LE %LONG  0x00080303 ; MC_EMEM_ADR_CFG_DEV0_0
D.S SD:0x7000F05C  %LE %LONG  0x00080303 ; MC_EMEM_ADR_CFG_DEV1_0
D.S SD:0x7000F050  %LE %LONG  0x00000800 ; MC_EMEM_CFG_0
D.S SD:0x7000F090  %LE %LONG  0x00000004 ; MC_EMEM_ARB_CFG_0
D.S SD:0x7000F094  %LE %LONG  0x80000036 ; MC_EMEM_ARB_OUTSTANDING_REQ_0
D.S SD:0x7000F098  %LE %LONG  0x00000001 ; MC_EMEM_ARB_TIMING_RCD_0
D.S SD:0x7000F09C  %LE %LONG  0x00000002 ; MC_EMEM_ARB_TIMING_RP_0
D.S SD:0x7000F0A0  %LE %LONG  0x00000007 ; MC_EMEM_ARB_TIMING_RC_0
D.S SD:0x7000F0A4  %LE %LONG  0x00000004 ; MC_EMEM_ARB_TIMING_RAS_0
D.S SD:0x7000F0A8  %LE %LONG  0x00000004 ; MC_EMEM_ARB_TIMING_FAW_0
D.S SD:0x7000F0AC  %LE %LONG  0x00000001 ; MC_EMEM_ARB_TIMING_RRD_0
D.S SD:0x7000F0B0  %LE %LONG  0x00000002 ; MC_EMEM_ARB_TIMING_RAP2PRE_0
D.S SD:0x7000F0B4  %LE %LONG  0x00000007 ; MC_EMEM_ARB_TIMING_WAP2PRE_0
D.S SD:0x7000F0B8  %LE %LONG  0x00000002 ; MC_EMEM_ARB_TIMING_R2R_0
D.S SD:0x7000F0BC  %LE %LONG  0x00000001 ; MC_EMEM_ARB_TIMING_W2W_0
D.S SD:0x7000F0C0  %LE %LONG  0x00000003 ; MC_EMEM_ARB_TIMING_R2W_0
D.S SD:0x7000F0C4  %LE %LONG  0x00000006 ; MC_EMEM_ARB_TIMING_W2R_0
D.S SD:0x7000F0D0  %LE %LONG  0x06030102 ; MC_EMEM_ARB_DA_TURNS_0
D.S SD:0x7000F0D4  %LE %LONG  0x000B0607 ; MC_EMEM_ARB_DA_COVERS_0
D.S SD:0x7000F0D8  %LE %LONG  0x70250E08 ; MC_EMEM_ARB_MISC0_0
D.S SD:0x7000F0DC  %LE %LONG  0x78000000 ; MC_EMEM_ARB_MISC1_0
D.S SD:0x7000F0E0  %LE %LONG  0x001F0000 ; MC_EMEM_ARB_RING1_THROTTLE_0
D.S SD:0x7000F0E8  %LE %LONG  0x00000080 ; MC_EMEM_ARB_OVERRIDE_0
D.S SD:0x7000F0EC  %LE %LONG  0xFF00FF00 ; MC_EMEM_ARB_RSV_0
D.S SD:0x7000F0FC  %LE %LONG  0x00000001 ; MC_TIMING_CONTROL_0
D.S SD:0x7000F0F4  %LE %LONG  0x00000000 ; MC_CLKEN_OVERRIDE_0
D.S SD:0x7000F410  %LE %LONG  0x00000001 ; EMC_ADR_CFG_0
D.S SD:0x7000F540  %LE %LONG  0x00000000 ; EMC_CLKEN_OVERRIDE_0
D.S SD:0x7000F6DC  %LE %LONG  0x00000802 ; EMC_CTT_TERM_CTRL_0
D.S SD:0x7000F6A8  %LE %LONG  0x00000000 ; EMC_AUTO_CAL_INTERVAL_0
D.S SD:0x7000F6A4  %LE %LONG  0xE0F11111 ; EMC_AUTO_CAL_CONFIG_0
wait 100.ms
D.S SD:0x7000F6B8  %LE %LONG  0x00000001 ; EMC_CFG_2_0
D.S SD:0x7000F408  %LE %LONG  0x01000400 ; EMC_DBG_0
D.S SD:0x7000F4F0  %LE %LONG  0x10004408 ; EMC_CMDQ_0
D.S SD:0x7000F4F4  %LE %LONG  0x06000404 ; EMC_MC2EMCQ_0
D.S SD:0x7000F4C8  %LE %LONG  0x01D0000C ; EMC_MRS_WAIT_CNT_0
D.S SD:0x7000F504  %LE %LONG  0x00006288 ; EMC_FBIO_CFG5_0
D.S SD:0x7000F42C  %LE %LONG  0x0000000E ; EMC_RC_0
D.S SD:0x7000F430  %LE %LONG  0x0000002F ; EMC_RFC_0
D.S SD:0x7000F434  %LE %LONG  0x0000000A ; EMC_RAS_0
D.S SD:0x7000F438  %LE %LONG  0x00000004 ; EMC_RP_0
D.S SD:0x7000F43C  %LE %LONG  0x00000003 ; EMC_R2W_0
D.S SD:0x7000F440  %LE %LONG  0x00000009 ; EMC_W2R_0
D.S SD:0x7000F444  %LE %LONG  0x00000003 ; EMC_R2P_0
D.S SD:0x7000F448  %LE %LONG  0x0000000A ; EMC_W2P_0
D.S SD:0x7000F44C  %LE %LONG  0x00000004 ; EMC_RD_RCD_0
D.S SD:0x7000F450  %LE %LONG  0x00000004 ; EMC_WR_RCD_0
D.S SD:0x7000F454  %LE %LONG  0x00000003 ; EMC_RRD_0
D.S SD:0x7000F458  %LE %LONG  0x00000001 ; EMC_REXT_0
D.S SD:0x7000F4B8  %LE %LONG  0x00000000 ; EMC_WEXT_0
D.S SD:0x7000F45C  %LE %LONG  0x00000004 ; EMC_WDV_0
D.S SD:0x7000F460  %LE %LONG  0x00000006 ; EMC_QUSE_0
D.S SD:0x7000F464  %LE %LONG  0x00000004 ; EMC_QRST_0
D.S SD:0x7000F468  %LE %LONG  0x00000008 ; EMC_QSAFE_0
D.S SD:0x7000F46C  %LE %LONG  0x0000000E ; EMC_RDV_0
D.S SD:0x7000F4BC  %LE %LONG  0x00000000 ; EMC_CTT_0
D.S SD:0x7000F6D8  %LE %LONG  0x00000000 ; EMC_CTT_DURATION_0
D.S SD:0x7000F470  %LE %LONG  0x000008E4 ; EMC_REFRESH_0
D.S SD:0x7000F474  %LE %LONG  0x00000000 ; EMC_BURST_REFRESH_NUM_0
D.S SD:0x7000F7DC  %LE %LONG  0x00000239 ; EMC_PRE_REFRESH_REQ_CNT_0
D.S SD:0x7000F478  %LE %LONG  0x00000002 ; EMC_PDEX2WR_0
D.S SD:0x7000F47C  %LE %LONG  0x00000002 ; EMC_PDEX2RD_0
D.S SD:0x7000F480  %LE %LONG  0x00000001 ; EMC_PCHG2PDEN_0
D.S SD:0x7000F484  %LE %LONG  0x00000000 ; EMC_ACT2PDEN_0
D.S SD:0x7000F488  %LE %LONG  0x00000007 ; EMC_AR2PDEN_0
D.S SD:0x7000F48C  %LE %LONG  0x0000000E ; EMC_RW2PDEN_0
D.S SD:0x7000F490  %LE %LONG  0x00000033 ; EMC_TXSR_0
D.S SD:0x7000F7E4  %LE %LONG  0x00000200 ; EMC_TXSRDLL_0
D.S SD:0x7000F494  %LE %LONG  0x00000004 ; EMC_TCKE_0
D.S SD:0x7000F498  %LE %LONG  0x00000009 ; EMC_TFAW_0
D.S SD:0x7000F49C  %LE %LONG  0x00000000 ; EMC_TRPAB_0
D.S SD:0x7000F4A0  %LE %LONG  0x00000004 ; EMC_TCLKSTABLE_0
D.S SD:0x7000F4A4  %LE %LONG  0x00000005 ; EMC_TCLKSTOP_0
D.S SD:0x7000F4A8  %LE %LONG  0x00000924 ; EMC_TREFBW_0
D.S SD:0x7000F4B0  %LE %LONG  0x00000000 ; EMC_ODT_WRITE_0
D.S SD:0x7000F4B4  %LE %LONG  0x00000000 ; EMC_ODT_READ_0
D.S SD:0x7000F4AC  %LE %LONG  0x00000000 ; EMC_QUSE_EXTRA_0
D.S SD:0x7000F514  %LE %LONG  0x00000004 ; EMC_FBIO_CFG6_0
D.S SD:0x7000F6BC  %LE %LONG  0xE02B0421 ; EMC_CFG_DIG_DLL_0
D.S SD:0x7000F6C0  %LE %LONG  0x00008000 ; EMC_CFG_DIG_DLL_PERIOD_0
D.S SD:0x7000F500  %LE %LONG  0x00000000 ; EMC_FBIO_SPARE_0
D.S SD:0x7000F520  %LE %LONG  0xFF00FF00 ; EMC_CFG_RSV_0
D.S SD:0x7000F728  %LE %LONG  0x00028000 ; EMC_DLL_XFORM_DQS0_0
D.S SD:0x7000F72C  %LE %LONG  0x00028000 ; EMC_DLL_XFORM_DQS1_0
D.S SD:0x7000F730  %LE %LONG  0x00028000 ; EMC_DLL_XFORM_DQS2_0
D.S SD:0x7000F734  %LE %LONG  0x00028000 ; EMC_DLL_XFORM_DQS3_0
D.S SD:0x7000F738  %LE %LONG  0x00028000 ; EMC_DLL_XFORM_DQS4_0
D.S SD:0x7000F73C  %LE %LONG  0x00028000 ; EMC_DLL_XFORM_DQS5_0
D.S SD:0x7000F740  %LE %LONG  0x00028000 ; EMC_DLL_XFORM_DQS6_0
D.S SD:0x7000F744  %LE %LONG  0x00028000 ; EMC_DLL_XFORM_DQS7_0
D.S SD:0x7000F748  %LE %LONG  0x00000000 ; EMC_DLL_XFORM_QUSE0_0
D.S SD:0x7000F74C  %LE %LONG  0x00000000 ; EMC_DLL_XFORM_QUSE1_0
D.S SD:0x7000F750  %LE %LONG  0x00000000 ; EMC_DLL_XFORM_QUSE2_0
D.S SD:0x7000F754  %LE %LONG  0x00000000 ; EMC_DLL_XFORM_QUSE3_0
D.S SD:0x7000F758  %LE %LONG  0x00000000 ; EMC_DLL_XFORM_QUSE4_0
D.S SD:0x7000F75C  %LE %LONG  0x00000000 ; EMC_DLL_XFORM_QUSE5_0
D.S SD:0x7000F760  %LE %LONG  0x00000000 ; EMC_DLL_XFORM_QUSE6_0
D.S SD:0x7000F764  %LE %LONG  0x00000000 ; EMC_DLL_XFORM_QUSE7_0
D.S SD:0x7000F768  %LE %LONG  0x0003C000 ; EMC_DLL_XFORM_DQ0_0
D.S SD:0x7000F76C  %LE %LONG  0x0003C000 ; EMC_DLL_XFORM_DQ1_0
D.S SD:0x7000F770  %LE %LONG  0x0003C000 ; EMC_DLL_XFORM_DQ2_0
D.S SD:0x7000F774  %LE %LONG  0x0003C000 ; EMC_DLL_XFORM_DQ3_0
D.S SD:0x7000F7A8  %LE %LONG  0x00000000 ; EMC_DLI_TRIM_TXDQS0_0
D.S SD:0x7000F7AC  %LE %LONG  0x00000000 ; EMC_DLI_TRIM_TXDQS1_0
D.S SD:0x7000F7B0  %LE %LONG  0x00000000 ; EMC_DLI_TRIM_TXDQS2_0
D.S SD:0x7000F7B4  %LE %LONG  0x00000000 ; EMC_DLI_TRIM_TXDQS3_0
D.S SD:0x7000F7B8  %LE %LONG  0x00000000 ; EMC_DLI_TRIM_TXDQS4_0
D.S SD:0x7000F7BC  %LE %LONG  0x00000000 ; EMC_DLI_TRIM_TXDQS5_0
D.S SD:0x7000F7C0  %LE %LONG  0x00000000 ; EMC_DLI_TRIM_TXDQS6_0
D.S SD:0x7000F7C4  %LE %LONG  0x00000000 ; EMC_DLI_TRIM_TXDQS7_0
D.S SD:0x7000F428  %LE %LONG  0x00000001 ; EMC_TIMING_CONTROL_0
wait 100.ms
D.S SD:0x7000F424  %LE %LONG  0x00000000 ; EMC_PIN_0
wait 100.ms
D.S SD:0x7000F424  %LE %LONG  0x00000100 ; EMC_PIN_0
wait 100.ms
D.S SD:0x7000F424  %LE %LONG  0x00000101 ; EMC_PIN_0
wait 100.ms
D.S SD:0x7000F4DC  %LE %LONG  0x00000001 ; EMC_NOP_0
D.S SD:0x7000F4D0  %LE %LONG  0x00200000 ; EMC_EMRS_0
D.S SD:0x7000F4D0  %LE %LONG  0x00300000 ; EMC_EMRS_0
D.S SD:0x7000F4D0  %LE %LONG  0x00100002 ; EMC_EMRS_0
D.S SD:0x7000F4CC  %LE %LONG  0x00001321 ; EMC_MRS_0
D.S SD:0x7000F6EC  %LE %LONG  0x80000011 ; EMC_ZQ_CAL_0
wait 100.ms
D.S SD:0x7000F6EC  %LE %LONG  0x40000011 ; EMC_ZQ_CAL_0
wait 100.ms
D.S SD:0x7000F6E0  %LE %LONG  0x00000000 ; EMC_ZCAL_INTERVAL_0
D.S SD:0x7000F6E4  %LE %LONG  0x00000040 ; EMC_ZCAL_WAIT_CNT_0
D.S SD:0x7000F6E8  %LE %LONG  0x00000000 ; EMC_ZCAL_MRW_CMD_0
D.S SD:0x7000F428  %LE %LONG  0x00000001 ; EMC_TIMING_CONTROL_0
D.S SD:0x7000F4D4  %LE %LONG  0x00000303 ; EMC_REF_0
D.S SD:0x7000F420  %LE %LONG  0x80000000 ; EMC_REFCTRL_0
D.S SD:0x7000F7E0  %LE %LONG  0x800012D7 ; EMC_DYN_SELF_REF_CONTROL_0
D.S SD:0x7000F40C  %LE %LONG  0x03C00000 ; EMC_CFG_0
D.S SD:0x7000F7D8  %LE %LONG  0x00040000 ; EMC_SEL_DPD_CTRL_0
D.S SD:0x7000F428  %LE %LONG  0x00000001 ; EMC_TIMING_CONTROL_0
D.S SD:0x6000C0E0  %LE %LONG  0x00010000 ; AHB_ARBITRATION_XBAR_CTRL_0
D.S SD:0x60006004  %LE %LONG  0x00000001 ; CLK_RST_CONTROLLER_RST_DEVICES_L_0
D.S SD:0x6000600C  %LE %LONG  0xFFF86000 ; CLK_RST_CONTROLLER_RST_DEVICES_U_0
D.S SD:0x60006358  %LE %LONG  0x007E0000 ; CLK_RST_CONTROLLER_RST_DEVICES_V_0
D.S SD:0x700032B4  %LE %LONG  0x00000060 ; PINMUX_AUX_PWR_I2C_SCL_0
D.S SD:0x700032B8  %LE %LONG  0x00000060 ; PINMUX_AUX_PWR_I2C_SDA_0
D.S SD:0x6000D684  %LE %LONG  0x00004000 ; GPIO_MSK_CNF_1_6
D.S SD:0x6000D684  %LE %LONG  0x00008000 ; GPIO_MSK_CNF_1_6
D.S SD:0x60006008  %LE %LONG  0x01008858 ; CLK_RST_CONTROLLER_RST_DEVICES_H_0
D.S SD:0x60006008  %LE %LONG  0x01000858 ; CLK_RST_CONTROLLER_RST_DEVICES_H_0
D.S SD:0x60006128  %LE %LONG  0xC000001D ; CLK_RST_CONTROLLER_CLK_SOURCE_DVC_I2C_0
D.S SD:0x60006014  %LE %LONG  0xFEFFF7F7 ; CLK_RST_CONTROLLER_CLK_OUT_ENB_H_0
D.S SD:0x70000868  %LE %LONG  0xF1612038 ; APB_MISC_GP_AOCFG1PADCTRL_0
D.S SD:0x7000D004  %LE %LONG  0x0000005A ; I2C_I2C_CMD_ADDR0_4
D.S SD:0x7000D000  %LE %LONG  0x00000002 ; I2C_I2C_CNFG_4
D.S SD:0x7000D00C  %LE %LONG  0x00002328 ; I2C_I2C_CMD_DATA1_4
D.S SD:0x7000D010  %LE %LONG  0x00000000 ; I2C_I2C_CMD_DATA2_4
D.S SD:0x7000D000  %LE %LONG  0x00000202 ; I2C_I2C_CNFG_4
wait 100.ms
wait 100.ms
D.S SD:0x7000D004  %LE %LONG  0x0000005A ; I2C_I2C_CMD_ADDR0_4
D.S SD:0x7000D000  %LE %LONG  0x00000002 ; I2C_I2C_CNFG_4
D.S SD:0x7000D00C  %LE %LONG  0x00000127 ; I2C_I2C_CMD_DATA1_4
D.S SD:0x7000D010  %LE %LONG  0x00000000 ; I2C_I2C_CMD_DATA2_4
D.S SD:0x7000D000  %LE %LONG  0x00000202 ; I2C_I2C_CNFG_4
wait 100.ms
wait 100.ms
D.S SD:0x600063B4  %LE %LONG  0x00000000 ; CLK_RST_CONTROLLER_CLK_SOURCE_MSELECT_0
D.S SD:0x60006440  %LE %LONG  0x00000008 ; CLK_RST_CONTROLLER_CLK_ENB_V_SET_0
D.S SD:0x60006434  %LE %LONG  0x00000008 ; CLK_RST_CONTROLLER_RST_DEV_V_CLR_0
D.S SD:0x70000024  %LE %LONG  0x000000C0 ; APB_MISC_PP_CONFIG_CTL_0
D.S SD:0x60006014  %LE %LONG  0xFEFFF7F7 ; CLK_RST_CONTROLLER_CLK_OUT_ENB_H_0
D.S SD:0x6000600C  %LE %LONG  0xFFF86000 ; CLK_RST_CONTROLLER_RST_DEVICES_U_0
D.S SD:0x60006010  %LE %LONG  0xFDFFFFF1 ; CLK_RST_CONTROLLER_CLK_OUT_ENB_L_0
D.S SD:0x60006018  %LE %LONG  0x75F79BFF ; CLK_RST_CONTROLLER_CLK_OUT_ENB_U_0
D.S SD:0x60006044  %LE %LONG  0x80000000 ; CLK_RST_CONTROLLER_CLK_MASK_ARM_0
D.S SD:0x7000E434  %LE %LONG  0x00001007 ; APBDEV_PMC_REMOVE_CLAMPING_CMD_0
D.S SD:0x60006020  %LE %LONG  0x20008888 ; CLK_RST_CONTROLLER_CCLK_BURST_POLICY_0
D.S SD:0x60006024  %LE %LONG  0x80000000 ; CLK_RST_CONTROLLER_SUPER_CCLK_DIVIDER_0
D.S SD:0x60006004  %LE %LONG  0x00000000 ; CLK_RST_CONTROLLER_RST_DEVICES_L_0
D.S SD:0x70050FB0  %LE %LONG  0xC5ACCE55 ; CSITE_CPUDBG0_LAR_0
D.S SD:0x7000E4A0  %LE %LONG  0x20000000 ; APBDEV_PMC_SCRATCH20_0
