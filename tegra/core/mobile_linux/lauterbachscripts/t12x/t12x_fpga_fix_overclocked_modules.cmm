; Copyright (c) 2012-2013, NVIDIA CORPORATION.  All rights reserved.
; For NVIDIA internal use only. Customers should not use this script
; unless NVIDIA explicitly directs them to do so.

; Some modules are overclocked by reset default.
; Fix them by providing safer divider values here for backdoor boot.
; The similar fix is done in BootLoader.

print "Fixing overclocked modules"
gosub safediv a:0x60006644 16. CLK_RST_CONTROLLER_CLK_SOURCE_SOC_THERM_0
gosub safediv a:0x60006134 16. CLK_RST_CONTROLLER_CLK_SOURCE_SPI1_0
gosub safediv a:0x60006118 16. CLK_RST_CONTROLLER_CLK_SOURCE_SPI2_0
gosub safediv a:0x6000611c 16. CLK_RST_CONTROLLER_CLK_SOURCE_SPI3_0
gosub safediv a:0x600061b4 16. CLK_RST_CONTROLLER_CLK_SOURCE_SPI4_0
gosub safediv a:0x600061d8 20. CLK_RST_CONTROLLER_CLK_SOURCE_I2S0_0
gosub safediv a:0x60006100 20. CLK_RST_CONTROLLER_CLK_SOURCE_I2S1_0
gosub safediv a:0x60006104 20. CLK_RST_CONTROLLER_CLK_SOURCE_I2S2_0
gosub safediv a:0x6000610c 16. CLK_RST_CONTROLLER_CLK_SOURCE_SPDIF_IN_0
gosub safediv a:0x600063e4 8.  CLK_RST_CONTROLLER_CLK_SOURCE_HDA2CODEC_2X_0
gosub safediv a:0x600061d0 6.  CLK_RST_CONTROLLER_CLK_SOURCE_NOR_0
gosub safediv a:0x600063b4 8.  CLK_RST_CONTROLLER_CLK_SOURCE_MSELECT_0
gosub safediv a:0x60006168 10. CLK_RST_CONTROLLER_CLK_SOURCE_VFIR_0
enddo

safediv:
  entry &addr &div &name
  &div=(&div-1)<<1
  &val=data.long(&addr)
  Data.Set &addr %LE %LONG (&val|&div)
  print "  &name: " format.hex(8,data.long(&addr))
  return
