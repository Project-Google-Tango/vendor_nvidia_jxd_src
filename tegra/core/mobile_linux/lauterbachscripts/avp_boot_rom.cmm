; Lauterbach TRACE32 debugger script to boot AVP with BootRom loaded into ROM RAMs by this script.

; For NVIDIA internal use only. Customers should not use this script
; unless NVIDIA explicitly directs them to do so.


; NOTE: THIS SCRIPT WILL WORK ONLY ON FPGAs.

winclear

; Setup JTAG for AVP-only.
system.reset
do &(TARGET_SOC)/&(TARGET_SOC)_avp_jtag_setup.cmm

; This should be set to "auto" if the symbol information
; is built with the correct labeling of "arm" vs. "thumb"
; mode code areas.
;system.option.dismode.auto
system.option.dismode.access

; Tell the debugger not to access non-existent memory locations.
do physical_setup.cmm

System.down
;Break.Delete
sYmbol.RESet

system.up

; For some reason the first system.up does not always work.
; Do another one to be sure.
wait 100.ms
system.up

print "Loading ROM image"
data.load.binary &(TOP)/vendor/nvidia/proprietary_src/top-secret/drivers/nvboot/t30/golden/boot_rom.irom.bin 0xFFF00000
r.s PC 0xFFF00000

print "Loading &FASTBOOT  symbols"
data.load.elf &FASTBOOT /nocode

IF "&TRANSLATE_SRC_PATH"=="TRUE"
(
  SYMBOL.SOURCEPATH.TRANSLATE "&BUILDTOP" "&TOP"
)

; Setup common toolbar items
do toolbar_setup.cmm

;mode.hll

enddo
