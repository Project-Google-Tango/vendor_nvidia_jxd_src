; Lauterbach TRACE32 debugger script to boot CPU on with FASTBOOT already present in SDRAM.

; We can locally modify the bootload handoff point depending on whether we have
; been loaded via the bootrom or debugger scripts
LOCAL &BIT_VERSION
&OS_HANDOFF="&BOOT_HANDOFF"

IF "&BACKDOOR_HANDOFF"==""
(
  &BACKDOOR_HANDOFF="&BOOT_HANDOFF"
)

winclear

; Setup JTAG for CPU.
do &(TARGET_SOC)/&(TARGET_SOC)_cpu_jtag_setup.cmm

; This should be set to "auto" if the symbol information
; is built with the correct labeling of "arm" vs. "thumb"
; mode code areas.
;system.option.dismode.auto
system.option.dismode.access

; Tell the debugger not to access non-existent memory locations.
do physical_setup.cmm

sYmbol.RESet

ON ERROR JUMPTO nobreak

system.mode.attach
break

; Read the BIT version from IRAM
&BIT_VERSION=data.long(D:0x40000000)

IF &BIT_VERSION==0x00000000
(
  ; Loaded by backdoor
  &OS_HANDOFF="&BACKDOOR_HANDOFF"
)
ELSE IF &BIT_VERSION==0xFFFFFFFF
(
  ; Loaded by backdoor
  &OS_HANDOFF="&BACKDOOR_HANDOFF"
)
ELSE
(
  ; Loaded by bootrom
  &OS_HANDOFF="&BOOT_HANDOFF"
)

nobreak:
ON ERROR

print "Loading &FASTBOOT symbols"
data.load.elf &FASTBOOT /NOCODE /GNU

IF "&TRANSLATE_SRC_PATH"=="TRUE"
(
  SYMBOL.SOURCEPATH.TRANSLATE "&BUILDTOP" "&TOP"
)

break.delete &BOOT_HANDOFF
break.set &OS_HANDOFF /Program /CMD "do cpu_lk.cmm" /onchip

; Setup common toolbar items
do toolbar_setup.cmm

; Set up the DCC debug console using the SWI interface.
IF "&ENABLE_DCC_WINDOW"=="TRUE"
(
  do cpu_dcc_swi_setup.cmm
)

IF ("&LOAD_SAVED_WINDOWS"=="TRUE")
(
  ; Restore saved window configuration (this is always saved in the $T32SYS directory -- don't change the path)
  do &T32SYS/windows.cmm
)

;mode.hll

enddo

